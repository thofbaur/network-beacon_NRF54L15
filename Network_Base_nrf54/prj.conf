## CMakeLists.txt
```
#
# Copyright (c) 2018 Nordic Semiconductor
#
# SPDX-License-Identifier: LicenseRef-Nordic-5-Clause
#
cmake_minimum_required(VERSION 3.20.0)

list(APPEND EXTRA_CONF_FILE ${CMAKE_CURRENT_SOURCE_DIR}/dsa.conf)

find_package(Zephyr REQUIRED HINTS $ENV{ZEPHYR_BASE})
project(Network_Base_nrf54)

target_include_directories(app PRIVATE ${CMAKE_CURRENT_SOURCE_DIR}/../shared)

# NORDIC SDK APP START
target_sources(app PRIVATE
  src/main.c
  src/led.c
  src/radio.c
  src/nus.c
  src/message_parser.c
  src/output.c
)

if(CONFIG_DSA_OUTPUT STREQUAL "UART")
  target_sources(app PRIVATE src/uart_output.c)
  target_compile_definitions(app PRIVATE DSA_OUTPUT_UART)
elseif(CONFIG_DSA_OUTPUT STREQUAL "RTT")
  target_sources(app PRIVATE src/rtt_output.c)
  target_compile_definitions(app PRIVATE DSA_OUTPUT_RTT)
else()
  message(FATAL_ERROR "Unsupported CONFIG_DSA_OUTPUT value: ${CONFIG_DSA_OUTPUT}. Use UART or RTT.")
endif()

if(CONFIG_DSA_OUTPUT_FORMAT_PARSED)
  target_compile_definitions(app PRIVATE DSA_OUTPUT_FORMAT_PARSED)
elseif(CONFIG_DSA_OUTPUT_FORMAT_RAW)
  target_compile_definitions(app PRIVATE DSA_OUTPUT_FORMAT_RAW)
endif()
# NORDIC SDK APP END
```

## Kconfig
```
#
# Copyright (c) 2024 Nordic Semiconductor
#
# SPDX-License-Identifier: LicenseRef-Nordic-5-Clause
#

source "Kconfig.zephyr"

config DSA_OUTPUT
	string "DSA output backend"
	default "UART"
	help
	  Select the output backend for DSA messages.
	  Supported values are UART and RTT.

config DSA_READOUT_LEVEL
	int "DSA readout level"
	range 0 7
	default 1
	help
	  Minimum decoded network data level required before connecting to a
	  matching DSA beacon.

config DSA_TARGET_BEACON_ID
	int "DSA target beacon id"
	range 0 255
	default 255
	help
	  Beacon id to exclusively connect to. 255 (0xFF) means accept any
	  beacon id that satisfies the other connect criteria (name,
	  manufacturer data, readout level).

choice DSA_OUTPUT_FORMAT
	prompt "DSA output data format"
	default DSA_OUTPUT_FORMAT_PARSED
	help
	  Select how received NUS packages are sent to the output backend.

config DSA_OUTPUT_FORMAT_PARSED
	bool "parsed"
	help
	  Parse known NUS packages and output readable text messages.

config DSA_OUTPUT_FORMAT_RAW
	bool "raw"
	help
	  Output each NUS package as raw bytes prepended with "ID" and the
	  current beacon ID as one byte.

endchoice

config SETTINGS
	default y

config ZMS
	default y if (SOC_FLASH_NRF_RRAM || SOC_FLASH_NRF_MRAM)

config NVS
	default y if !(SOC_FLASH_NRF_RRAM || SOC_FLASH_NRF_MRAM)
```

## prj.conf
```kconfig
#
# Copyright (c) 2018 Nordic Semiconductor
#
# SPDX-License-Identifier: LicenseRef-Nordic-5-Clause
#

# Enable the UART driver
CONFIG_DSA_OUTPUT="UART"
CONFIG_DSA_OUTPUT_FORMAT_RAW=y
CONFIG_SERIAL=y
CONFIG_CONSOLE=y
CONFIG_UART_CONSOLE=y
# DMA-driven (EasyDMA/UARTE) TX for uart_output.c instead of blocking
# uart_poll_out(): frees the CPU during transmission so a large output
# burst can't stall BT notification processing behind it. See the comment
# on uart_output_flush() in uart_output.c.
CONFIG_UART_ASYNC_API=y
CONFIG_GPIO=y
CONFIG_DK_LIBRARY=y

# Enable the BLE stack with GATT Client configuration
CONFIG_BT=y
CONFIG_BT_CENTRAL=y
CONFIG_BT_GATT_CLIENT=y
CONFIG_BT_GATT_AUTO_DISCOVER_CCC=y

# BLE throughput / MTU negotiation
CONFIG_BT_L2CAP_TX_MTU=247
CONFIG_BT_BUF_ACL_RX_SIZE=251
# Default is BT_MAX_CONN (1), giving only BT_MAX_CONN + 1 = 2 incoming ACL
# buffers total - the controller can hold almost nothing ahead of the host
# draining it. A beacon dumping a large contact backlog (hundreds-low
# thousands of entries, sent as fast as the link allows) can outrun that
# in a single burst; the beacon commits/drops each batch once its own send
# is confirmed, regardless of whether this host ever actually caught it,
# so an overrun here shows up as silently missing data, not an error.
# More headroom doesn't guarantee against an arbitrarily large burst, but
# it raises the burst size before backpressure/loss can start.
CONFIG_BT_BUF_ACL_RX_COUNT_EXTRA=16
CONFIG_BT_BUF_ACL_TX_SIZE=251
CONFIG_BT_BUF_ACL_TX_COUNT=6
CONFIG_BT_L2CAP_TX_BUF_COUNT=6
CONFIG_BT_ATT_TX_COUNT=6
CONFIG_BT_CTLR_DATA_LENGTH_MAX=251
CONFIG_BT_DATA_LEN_UPDATE=y
CONFIG_BT_USER_DATA_LEN_UPDATE=y
CONFIG_BT_USER_PHY_UPDATE=y

# Enable the BLE modules from NCS
CONFIG_BT_NUS_CLIENT=y
CONFIG_BT_GATT_DM=y
CONFIG_HEAP_MEM_POOL_SIZE=2048

# This example requires more stack
CONFIG_SYSTEM_WORKQUEUE_STACK_SIZE=2048
# Enable bonding
CONFIG_BT_SETTINGS=y
CONFIG_FLASH=y
CONFIG_FLASH_PAGE_LAYOUT=y
CONFIG_FLASH_MAP=y

# Config logger
CONFIG_LOG=y
CONFIG_USE_SEGGER_RTT=y
CONFIG_SEGGER_RTT_MODE_BLOCK_IF_FIFO_FULL=y
CONFIG_LOG_BACKEND_RTT=y
CONFIG_LOG_BACKEND_RTT_MODE_BLOCK=y
CONFIG_LOG_BACKEND_UART=n
CONFIG_LOG_PRINTK=n

CONFIG_ASSERT=y
```

## dsa.conf
```kconfig
CONFIG_DSA_READOUT_LEVEL=3
CONFIG_DSA_TARGET_BEACON_ID=255
```

## src/main.c
```c
#include <dk_buttons_and_leds.h>
#include <zephyr/kernel.h>
#include <zephyr/logging/log.h>
#include <zephyr/sys/printk.h>

#include "led.h"
#include "nus.h"
#include "output.h"
#include "radio.h"

LOG_MODULE_REGISTER(network_base, LOG_LEVEL_INF);

/* radio_start_scanning_with_level() takes the raw readout-level nibble
 * (0-7, per should_connect_to_adv()) advertised by a beacon, not the
 * shared DATA_LEVEL_* contact-count thresholds beacons use internally to
 * derive that nibble.
 */
static void button_handler(uint32_t button_state, uint32_t has_changed)
{
	if ((has_changed & DK_BTN1_MSK) && (button_state & DK_BTN1_MSK)) {
		LOG_INF("Button0 pressed: start scanning at data level 3");
		(void)radio_start_scanning_with_level(3);
	}

	if ((has_changed & DK_BTN2_MSK) && (button_state & DK_BTN2_MSK)) {
		LOG_INF("Button1 pressed: wait for finished, then stop");
		radio_request_stop_after_finished();
	}

	if ((has_changed & DK_BTN3_MSK) && (button_state & DK_BTN3_MSK)) {
		LOG_INF("Button2 pressed: start scanning at data level 2");
		(void)radio_start_scanning_with_level(2);
	}

	if ((has_changed & DK_BTN4_MSK) && (button_state & DK_BTN4_MSK)) {
		LOG_INF("Button3 pressed: start scanning at data level 1");
		(void)radio_start_scanning_with_level(1);
	}
}

static void on_radio_connected(struct bt_conn *conn, uint8_t beacon_id,
			       uint8_t status)
{
	nus_on_connected(conn, beacon_id, status);
}

static void on_radio_disconnected(void)
{
	nus_on_disconnected();
}

static void on_nus_finished(void)
{
	radio_transfer_finished();
}

int main(void)
{
	int err;
	const struct radio_callbacks callbacks = {
		.connected = on_radio_connected,
		.disconnected = on_radio_disconnected,
	};

	err = led_init();
	if (err) {
		return 0;
	}

	led_set_running(true);

	err = dk_buttons_init(button_handler);
	if (err) {
		LOG_ERR("Button init failed (err %d)", err);
		return 0;
	}

	err = output_init();
	if (err) {
		LOG_ERR("Output init failed (err %d)", err);
		return 0;
	}

	err = radio_init(&callbacks);
	if (err) {
		return 0;
	}

	err = nus_init(on_nus_finished);
	if (err) {
		return 0;
	}

	printk("Network base ready. Press button0 to connect at data level 3. Press button1 to stop connecting. Press button2 to connect at data level 2. Press button3 to connect at data level 1\n");

	for (;;) {
		k_sleep(K_FOREVER);
	}
}
```

## src/led.c
```c
#include "led.h"

#include <dk_buttons_and_leds.h>
#include <zephyr/logging/log.h>

LOG_MODULE_DECLARE(network_base);

int led_init(void)
{
	int err = dk_leds_init();

	if (err) {
		LOG_ERR("LED init failed (err %d)", err);
		return err;
	}

	(void)dk_set_leds(DK_NO_LEDS_MSK);
	return 0;
}

void led_set_running(bool active)
{
	(void)dk_set_led(DK_LED1, active ? 1 : 0);
}

void led_set_scanning(bool active)
{
	(void)dk_set_led(DK_LED2, active ? 1 : 0);
}

void led_set_connected(bool active)
{
	(void)dk_set_led(DK_LED3, active ? 1 : 0);
}
```

## src/led.h
```c
#ifndef LED_H_
#define LED_H_

#include <stdbool.h>

int led_init(void);
void led_set_running(bool active);
void led_set_scanning(bool active);
void led_set_connected(bool active);

#endif /* LED_H_ */
```

## src/message_parser.c
```c
#include "message_parser.h"

#include <stddef.h>
#include <string.h>

#include <zephyr/logging/log.h>
#include <zephyr/sys/printk.h>

#include "common_include.h"
#include "output.h"

LOG_MODULE_DECLARE(network_base);

#define DSA_TIME_LEN 4
#define DSA_DATA_COUNT_LEN 1
#define DSA_DATA_SET_LEN 5
#define DSA_SELF_REPORT_COUNT_LEN 1
#define DSA_SELF_REPORT_SET_LEN 3
#define DSA_ECO_LOG_COUNT_LEN 1
#define DSA_ECO_LOG_SET_LEN 6
#define DSA_VOLTAGE_LEN 2
#define DSA_CONTROL_LEN 8
#define DSA_TIME_CONTACT_VOLTAGE_LEN 9

static message_parser_finished_cb_t parser_finished_cb;

static size_t expected_len_for_flag(uint8_t flag)
{
	switch (flag) {
	case DSA_NUS_FLAG_TIME:
		return DSA_TIME_LEN;
	case DSA_NUS_FLAG_TIME_CONTACTS_VOLTAGE:
		return DSA_TIME_CONTACT_VOLTAGE_LEN;
	case DSA_NUS_FLAG_DATA:
		return DSA_DATA_COUNT_LEN;
	case DSA_NUS_FLAG_VOLTAGE:
		return DSA_VOLTAGE_LEN;
	case DSA_NUS_FLAG_CONTROL:
		return DSA_CONTROL_LEN;
	case DSA_NUS_FLAG_SELF_REPORT:
		return DSA_SELF_REPORT_COUNT_LEN;
	case DSA_NUS_FLAG_ECO_LOG:
		return DSA_ECO_LOG_COUNT_LEN;
	default:
		return 0;
	}
}

static bool is_known_flag(uint8_t byte)
{
	return expected_len_for_flag(byte) != 0;
}

static uint32_t uint32_be_decode(const uint8_t *data)
{
	return ((uint32_t)data[0] << 24) | ((uint32_t)data[1] << 16) |
	       ((uint32_t)data[2] << 8) | data[3];
}

static uint32_t uint24_be_decode(const uint8_t *data)
{
	return ((uint32_t)data[0] << 16) | ((uint32_t)data[1] << 8) |
	       data[2];
}

static uint32_t uint16_be_decode(const uint8_t *data)
{
	return ((uint32_t)data[0] << 8) | data[1];
}

static void handle_time_package(uint8_t beacon_id, const uint8_t *data)
{
	uint32_t timer = uint32_be_decode(data);

	output_messagef("ID: %u Current Timer:%u", beacon_id, timer);
}

static void handle_time_contact_voltage_package(uint8_t beacon_id,
						const uint8_t *data)
{
	uint32_t timer = uint32_be_decode(data);
	uint32_t contact_count = uint24_be_decode(&data[4]);
	uint16_t voltage = uint16_be_decode(&data[7]);

	output_messagef("ID: %u Current Timer: %u Contact Count: %u Voltage: %u",
			beacon_id, timer, contact_count, voltage);
}

static void handle_data_package(uint8_t beacon_id, const uint8_t *data)
{
	uint8_t contact_id = data[0];
	uint32_t timer = uint24_be_decode(&data[1]);
	uint8_t negative_rssi = data[4];

	output_messagef("ID: %u Contact-ID: %u Timer: %u RSSI: -%u", beacon_id,
			contact_id, timer, negative_rssi);
}

static void handle_data_block(uint8_t beacon_id, const uint8_t *data,
			      size_t len)
{
	uint8_t set_count = data[0];
	size_t expected_len = DSA_DATA_COUNT_LEN +
			      ((size_t)set_count * DSA_DATA_SET_LEN);

	if (len != expected_len) {
		LOG_WRN("Invalid DATA block length %u for %u contacts",
			(unsigned int)len, set_count);
		return;
	}

	for (size_t i = 0; i < set_count; i++) {
		handle_data_package(beacon_id,
				    &data[DSA_DATA_COUNT_LEN +
					  (i * DSA_DATA_SET_LEN)]);
	}
}

static void handle_voltage_package(uint8_t beacon_id, const uint8_t *data)
{
	uint16_t voltage = uint16_be_decode(data);

	output_messagef("ID: %u VOLTAGE: %u", beacon_id, voltage);
}

static void handle_self_report_block(uint8_t beacon_id, const uint8_t *data,
				     size_t len)
{
	uint8_t report_count = data[0];
	size_t expected_len = DSA_SELF_REPORT_COUNT_LEN +
			      ((size_t)report_count * DSA_SELF_REPORT_SET_LEN);

	if (len != expected_len) {
		LOG_WRN("Invalid SELF_REPORT block length %u for %u reports",
			(unsigned int)len, report_count);
		return;
	}

	for (size_t i = 0; i < report_count; i++) {
		uint32_t timer = uint24_be_decode(
			&data[DSA_SELF_REPORT_COUNT_LEN +
			      (i * DSA_SELF_REPORT_SET_LEN)]);

		output_messagef("ID: %u  Self-report time: %u", beacon_id,
				timer);
	}
}

static void handle_eco_log_block(uint8_t beacon_id, const uint8_t *data,
				 size_t len)
{
	uint8_t entry_count = data[0];
	size_t expected_len = DSA_ECO_LOG_COUNT_LEN +
			      ((size_t)entry_count * DSA_ECO_LOG_SET_LEN);

	if (len != expected_len) {
		LOG_WRN("Invalid ECO_LOG block length %u for %u entries",
			(unsigned int)len, entry_count);
		return;
	}

	for (size_t i = 0; i < entry_count; i++) {
		const uint8_t *entry = &data[DSA_ECO_LOG_COUNT_LEN +
					     (i * DSA_ECO_LOG_SET_LEN)];
		uint32_t enter_time = uint24_be_decode(entry);
		uint32_t leave_time = uint24_be_decode(&entry[3]);

		output_messagef("ID: %u Eco session enter: %u leave: %u",
				beacon_id, enter_time, leave_time);
	}
}

static void handle_control_package(uint8_t beacon_id, const uint8_t *data)
{
	if (memcmp(data, "finished", DSA_CONTROL_LEN) == 0) {
		output_messagef("ID: %u Transfer complete. Disconnecting",
				beacon_id);

		LOG_INF("Received finished control package");

		if (parser_finished_cb) {
			parser_finished_cb();
		}
	}
}

static void handle_default_package(uint8_t beacon_id, const uint8_t *data,
				   size_t len)
{
	char message[160];
	size_t pos;

	if (len == 0) {
		output_messagef("ID: %u DEFAULT uint8=<empty>", beacon_id);
		return;
	}

	pos = snprintk(message, sizeof(message), "ID: %u DEFAULT uint8=",
		       beacon_id);

	for (size_t i = 0; (i < len) && (pos < sizeof(message)); i++) {
		int written = snprintk(&message[pos], sizeof(message) - pos,
				       "%u%s", data[i],
				       (i + 1 == len) ? "" : " ");

		if (written < 0) {
			break;
		}

		pos += (size_t)written;
	}

	message[sizeof(message) - 1] = '\0';
	output_message(message);
}

static void handle_complete_package(uint8_t beacon_id, uint8_t flag,
				    const uint8_t *data, size_t len)
{
	switch (flag) {
	case DSA_NUS_FLAG_TIME:
		if (len != DSA_TIME_LEN) {
			LOG_WRN("Invalid TIME package length %u",
				(unsigned int)len);
			break;
		}
		handle_time_package(beacon_id, data);
		break;
	case DSA_NUS_FLAG_TIME_CONTACTS_VOLTAGE:
		if (len != DSA_TIME_CONTACT_VOLTAGE_LEN) {
			LOG_WRN("Invalid TIME+CONTACT+VOLTAGE package length %u",
				(unsigned int)len);
			break;
		}
		handle_time_contact_voltage_package(beacon_id, data);
		break;
	case DSA_NUS_FLAG_DATA:
		if (len < DSA_DATA_COUNT_LEN) {
			LOG_WRN("Invalid DATA block length %u",
				(unsigned int)len);
			break;
		}
		handle_data_block(beacon_id, data, len);
		break;
	case DSA_NUS_FLAG_VOLTAGE:
		if (len != DSA_VOLTAGE_LEN) {
			LOG_WRN("Invalid VOLTAGE package length %u",
				(unsigned int)len);
			break;
		}
		handle_voltage_package(beacon_id, data);
		break;
	case DSA_NUS_FLAG_CONTROL:
		if (len != DSA_CONTROL_LEN) {
			LOG_WRN("Invalid CONTROL package length %u",
				(unsigned int)len);
			break;
		}
		handle_control_package(beacon_id, data);
		break;
	case DSA_NUS_FLAG_SELF_REPORT:
		if (len < DSA_SELF_REPORT_COUNT_LEN) {
			LOG_WRN("Invalid SELF_REPORT block length %u",
				(unsigned int)len);
			break;
		}
		handle_self_report_block(beacon_id, data, len);
		break;
	case DSA_NUS_FLAG_ECO_LOG:
		if (len < DSA_ECO_LOG_COUNT_LEN) {
			LOG_WRN("Invalid ECO_LOG block length %u",
				(unsigned int)len);
			break;
		}
		handle_eco_log_block(beacon_id, data, len);
		break;
	default:
		handle_default_package(beacon_id, data, len);
		break;
	}
}

void message_parser_init(message_parser_finished_cb_t finished_cb)
{
	parser_finished_cb = finished_cb;
	message_parser_reset();
}

void message_parser_reset(void)
{
	/* Stateless parser: each NUS notification carries one complete package. */
}

void message_parser_feed(uint8_t beacon_id, const uint8_t *data, uint16_t len)
{
	uint8_t flag;

	if (len < 1) {
		LOG_WRN("Ignoring empty NUS package");
		return;
	}

	flag = data[0];
	if (!is_known_flag(flag)) {
		LOG_INF("No known NUS flag matched; using default data package");
		handle_default_package(beacon_id, data, len);
		return;
	}

	handle_complete_package(beacon_id, flag, &data[1], len - 1);
}
```

## src/message_parser.h
```c
#ifndef MESSAGE_PARSER_H_
#define MESSAGE_PARSER_H_

#include <stdint.h>

typedef void (*message_parser_finished_cb_t)(void);

void message_parser_init(message_parser_finished_cb_t finished_cb);
void message_parser_reset(void);
void message_parser_feed(uint8_t beacon_id, const uint8_t *data, uint16_t len);

#endif /* MESSAGE_PARSER_H_ */
```

## src/nus.c
```c
#include "nus.h"

#include <errno.h>
#include <string.h>

#include <bluetooth/gatt_dm.h>
#include <bluetooth/services/nus.h>
#include <bluetooth/services/nus_client.h>
#include <zephyr/bluetooth/gatt.h>
#include <zephyr/kernel.h>
#include <zephyr/logging/log.h>

#include "common_include.h"
#include "message_parser.h"
#include "output.h"

LOG_MODULE_DECLARE(network_base);

#define NUS_WRITE_TIMEOUT K_MSEC(150)
#define NUS_START_COMMAND "st"
#define NUS_RX_IDLE_TIMEOUT K_SECONDS(10)
#define NUS_RAW_PREFIX_LEN 3
#define NUS_RAW_SUFFIX_LEN 2
#define NUS_CONNECT_STATUS_LEN 1

static struct bt_nus_client nus_client;
static nus_finished_cb_t finished_cb;
static struct k_work_delayable rx_idle_timeout_work;
/* The beacon ID a received notification gets tagged with must be looked up
 * by which connection it actually arrived on (nus->conn), not read from a
 * bare "whichever beacon is current right now" global: nus_client is a
 * single instance reused across connections, and if a notification from the
 * previous beacon is still being processed when the next one connects, a
 * global updated only at connect time would mislabel it under the new
 * beacon's ID instead of the one it actually came from.
 */
static struct bt_conn *tagged_conn;
static uint8_t tagged_beacon_id;

K_SEM_DEFINE(nus_write_sem, 0, 1);

static void rx_idle_timeout_handler(struct k_work *work)
{
	ARG_UNUSED(work);

	LOG_WRN("No NUS data received before timeout; terminating connection");

	if (finished_cb) {
		finished_cb();
	}
}

static void rx_idle_timeout_restart(void)
{
	k_work_reschedule(&rx_idle_timeout_work, NUS_RX_IDLE_TIMEOUT);
}

static void rx_idle_timeout_stop(void)
{
	(void)k_work_cancel_delayable(&rx_idle_timeout_work);
}

static void parser_finished(void)
{
	rx_idle_timeout_stop();

	if (finished_cb) {
		finished_cb();
	}
}

static void data_sent(struct bt_nus_client *nus, uint8_t err,
		      const uint8_t *const data, uint16_t len)
{
	ARG_UNUSED(nus);
	ARG_UNUSED(data);
	ARG_UNUSED(len);

	if (err) {
		LOG_WRN("NUS send ATT error 0x%02x", err);
	}

	k_sem_give(&nus_write_sem);
}

/* Acks a received (domain, count) batch back to the beacon so it knows the
 * data actually made it here before dropping it from its own storage - see
 * the DSA_NUS_ACK_MAGIC comment in common_include.h. Reuses the same write
 * mechanism/semaphore as send_start_command(); safe because data_received()
 * calls are already sequential (one notification at a time), so there's
 * never a write-in-flight when this runs.
 */
static int send_ack(uint8_t domain, uint8_t count)
{
	int err;
	uint8_t ack[] = { DSA_NUS_ACK_MAGIC, domain, count };

	err = bt_nus_client_send(&nus_client, ack, sizeof(ack));
	if (err) {
		LOG_WRN("Failed to send ack (domain 0x%02x, err %d)", domain, err);
		return err;
	}

	err = k_sem_take(&nus_write_sem, NUS_WRITE_TIMEOUT);
	if (err) {
		LOG_WRN("NUS ack send timeout (domain 0x%02x)", domain);
		return err;
	}

	return 0;
}

static bool nus_flag_is_ackable(uint8_t flag)
{
	return flag == DSA_NUS_FLAG_DATA || flag == DSA_NUS_FLAG_SELF_REPORT ||
	       flag == DSA_NUS_FLAG_ECO_LOG;
}

static uint8_t data_received(struct bt_nus_client *nus,
			     const uint8_t *data, uint16_t len)
{
	rx_idle_timeout_restart();

	if (nus->conn != tagged_conn) {
		/* Notification for a connection we no longer believe is the
		 * tracked beacon (e.g. it was still in flight when the next
		 * beacon connected). Drop it rather than tagging it with the
		 * wrong beacon's ID - silently missing data is the existing,
		 * acknowledged failure mode under link overrun (see the ACL
		 * RX buffer comment in prj.conf); mislabeling it under a
		 * different beacon is strictly worse, since it corrupts that
		 * other beacon's contact history instead.
		 */
		LOG_WRN("Dropping NUS notification for a stale/untracked connection "
			"(conn=%p tagged_conn=%p)", (void *)nus->conn, (void *)tagged_conn);
		return BT_GATT_ITER_CONTINUE;
	}

#if defined(DSA_OUTPUT_FORMAT_RAW)
	uint8_t raw_data[NUS_RAW_PREFIX_LEN + CONFIG_BT_L2CAP_TX_MTU +
			 NUS_RAW_SUFFIX_LEN] = {
		'I', 'D', tagged_beacon_id
	};
	size_t raw_len = MIN((size_t)len, CONFIG_BT_L2CAP_TX_MTU);
	size_t raw_total_len = NUS_RAW_PREFIX_LEN + raw_len + NUS_RAW_SUFFIX_LEN;

	memcpy(&raw_data[NUS_RAW_PREFIX_LEN], data, raw_len);
	raw_data[NUS_RAW_PREFIX_LEN + raw_len] = '\r';
	raw_data[NUS_RAW_PREFIX_LEN + raw_len + 1] = '\n';
	output_data(raw_data, raw_total_len);

	/* Ack after the payload is safely queued for output, not before -
	 * that's the durability boundary this protocol relies on.
	 */
	if (len >= 2 && nus_flag_is_ackable(data[0])) {
		(void)send_ack(data[0], data[1]);
	}
#else
	message_parser_feed(tagged_beacon_id, data, len);
#endif
	return BT_GATT_ITER_CONTINUE;
}

static int send_start_command(void)
{
	int err;
	static const uint8_t start_command[] = NUS_START_COMMAND;

	err = bt_nus_client_send(&nus_client, start_command,
				 sizeof(start_command) - 1);
	if (err) {
		LOG_WRN("Failed to send start command (err %d)", err);
		return err;
	}

	err = k_sem_take(&nus_write_sem, NUS_WRITE_TIMEOUT);
	if (err) {
		LOG_WRN("NUS start command send timeout");
		return err;
	}

	LOG_INF("Sent NUS start command");
	return 0;
}

static void discovery_complete(struct bt_gatt_dm *dm, void *context)
{
	struct bt_nus_client *nus = context;
	int err;

	LOG_INF("NUS service discovery completed");

	err = bt_nus_handles_assign(dm, nus);
	if (err) {
		LOG_WRN("NUS handle assignment failed (err %d)", err);
		goto release;
	}

	err = bt_nus_subscribe_receive(nus);
	if (err) {
		LOG_WRN("NUS subscribe failed (err %d)", err);
		goto release;
	}

	(void)send_start_command();

release:
	bt_gatt_dm_data_release(dm);
}

static void discovery_service_not_found(struct bt_conn *conn, void *context)
{
	ARG_UNUSED(conn);
	ARG_UNUSED(context);

	LOG_WRN("NUS service not found");
}

static void discovery_error(struct bt_conn *conn, int err, void *context)
{
	ARG_UNUSED(conn);
	ARG_UNUSED(context);

	LOG_WRN("NUS discovery error (err %d)", err);
}

static struct bt_gatt_dm_cb discovery_cb = {
	.completed = discovery_complete,
	.service_not_found = discovery_service_not_found,
	.error_found = discovery_error,
};

int nus_init(nus_finished_cb_t cb)
{
	int err;
	struct bt_nus_client_init_param init = {
		.cb = {
			.received = data_received,
			.sent = data_sent,
		},
	};

	finished_cb = cb;
	k_work_init_delayable(&rx_idle_timeout_work, rx_idle_timeout_handler);
	message_parser_init(parser_finished);

	err = bt_nus_client_init(&nus_client, &init);
	if (err) {
		LOG_ERR("NUS client init failed (err %d)", err);
		return err;
	}

	LOG_INF("NUS client initialized");
	return 0;
}

static void send_connect_status(uint8_t beacon_id, uint8_t status)
{
#if defined(DSA_OUTPUT_FORMAT_RAW)
	uint8_t raw_data[NUS_RAW_PREFIX_LEN + 1 + NUS_CONNECT_STATUS_LEN +
			 NUS_RAW_SUFFIX_LEN] = {
		'I', 'D', beacon_id, DSA_NUS_FLAG_CONNECT_STATUS, status,
		'\r', '\n'
	};

	output_data(raw_data, sizeof(raw_data));
#else
	output_messagef("ID: %u, Status: %u", beacon_id, status);
#endif
}

void nus_on_connected(struct bt_conn *conn, uint8_t beacon_id, uint8_t status)
{
	int err;

	tagged_conn = conn;
	tagged_beacon_id = beacon_id;
	message_parser_reset();
	rx_idle_timeout_restart();

	send_connect_status(beacon_id, status);

	err = bt_gatt_dm_start(conn, BT_UUID_NUS_SERVICE, &discovery_cb,
			       &nus_client);
	if (err) {
		LOG_WRN("NUS discovery start failed (err %d)", err);
	}
}

void nus_on_disconnected(void)
{
	/* Stop tagging: any notification that still arrives in the gap
	 * before the next beacon's own nus_on_connected() belongs to no
	 * currently-tracked connection and must be dropped, not attributed
	 * to whichever beacon we were last talking to.
	 */
	tagged_conn = NULL;
	rx_idle_timeout_stop();
	message_parser_reset();
}
```

## src/nus.h
```c
#ifndef NUS_H_
#define NUS_H_

#include <zephyr/bluetooth/conn.h>
#include <stdint.h>

typedef void (*nus_finished_cb_t)(void);

int nus_init(nus_finished_cb_t finished_cb);
void nus_on_connected(struct bt_conn *conn, uint8_t beacon_id, uint8_t status);
void nus_on_disconnected(void);

#endif /* NUS_H_ */
```

## src/output.c
```c
#include "output.h"

#include <errno.h>
#include <stdarg.h>
#include <stdbool.h>
#include <stddef.h>
#include <stdint.h>
#include <string.h>

#include <zephyr/kernel.h>
#include <zephyr/logging/log.h>
#include <zephyr/sys/printk.h>

#if defined(DSA_OUTPUT_RTT)
#include "rtt_output.h"
#elif defined(DSA_OUTPUT_UART)
#include "uart_output.h"
#endif

#define OUTPUT_RAW_PREFIX_MAX 3
#define OUTPUT_RAW_SUFFIX_MAX 2
#define OUTPUT_DATA_MAX \
	(OUTPUT_RAW_PREFIX_MAX + CONFIG_BT_L2CAP_TX_MTU + OUTPUT_RAW_SUFFIX_MAX)
#define OUTPUT_MESSAGE_MAX 160
#define OUTPUT_QUEUE_LEN 16
#define OUTPUT_THREAD_STACK_SIZE 1024
#define OUTPUT_THREAD_PRIORITY 7

LOG_MODULE_DECLARE(network_base);

struct output_item {
	uint8_t data[OUTPUT_DATA_MAX];
	size_t len;
	bool text;
};

K_MSGQ_DEFINE(output_queue, sizeof(struct output_item), OUTPUT_QUEUE_LEN, 4);
K_THREAD_STACK_DEFINE(output_thread_stack, OUTPUT_THREAD_STACK_SIZE);

static struct k_thread output_thread;
static bool output_ready;

static void output_thread_fn(void *p1, void *p2, void *p3)
{
	struct output_item item;

	ARG_UNUSED(p1);
	ARG_UNUSED(p2);
	ARG_UNUSED(p3);

	for (;;) {
		k_msgq_get(&output_queue, &item, K_FOREVER);
#if defined(DSA_OUTPUT_RTT)
		if (item.text) {
			rtt_output_message((const char *)item.data);
		} else {
			rtt_output_data(item.data, item.len);
		}
#elif defined(DSA_OUTPUT_UART)
		if (item.text) {
			uart_output_message((const char *)item.data);
		} else {
			uart_output_data(item.data, item.len);
		}
#else
		LOG_WRN("No output backend selected");
#endif
	}
}

int output_init(void)
{
	int err;

#if defined(DSA_OUTPUT_RTT)
	err = rtt_output_init();
#elif defined(DSA_OUTPUT_UART)
	err = uart_output_init();
#else
	return -ENODEV;
#endif

	if (err) {
		return err;
	}

	output_ready = true;

	k_thread_create(&output_thread, output_thread_stack,
			K_THREAD_STACK_SIZEOF(output_thread_stack),
			output_thread_fn, NULL, NULL, NULL,
			OUTPUT_THREAD_PRIORITY, 0, K_NO_WAIT);
	k_thread_name_set(&output_thread, "output");

	return 0;
}

static void output_item_submit(struct output_item *item)
{
	if (!output_ready) {
		return;
	}

	if (k_msgq_put(&output_queue, item, K_FOREVER) != 0) {
		LOG_ERR("Output queue put failed");
	}
}

bool output_queue_is_drained(void)
{
	return k_msgq_num_used_get(&output_queue) == 0;
}

void output_data(const uint8_t *data, size_t len)
{
	struct output_item item = {
		.len = MIN(len, sizeof(item.data)),
		.text = false,
	};

	if (item.len > 0) {
		memcpy(item.data, data, item.len);
	}
	output_item_submit(&item);
}

void output_message(const char *message)
{
	struct output_item item = {
		.text = true,
	};

	(void)snprintk((char *)item.data, sizeof(item.data), "%s", message);
	item.len = strlen((const char *)item.data);
	output_item_submit(&item);
}

void output_messagef(const char *fmt, ...)
{
	char message[OUTPUT_MESSAGE_MAX];
	va_list args;

	va_start(args, fmt);
	(void)vsnprintk(message, sizeof(message), fmt, args);
	va_end(args);

	output_message(message);
}
```

## src/output.h
```c
#ifndef OUTPUT_H_
#define OUTPUT_H_

#include <stdbool.h>
#include <stddef.h>
#include <stdint.h>

int output_init(void);
void output_data(const uint8_t *data, size_t len);
void output_message(const char *message);
void output_messagef(const char *fmt, ...);

/* True once the output queue has fully drained (everything handed to
 * output_data()/output_message() so far has been written out). Used to hold
 * off connecting to the next beacon until the previous one's backlog is no
 * longer competing for the same limited queue slots - see radio.c's
 * scan_recv().
 */
bool output_queue_is_drained(void);

#endif /* OUTPUT_H_ */
```

## src/radio.c
```c
#include "radio.h"

#include <errno.h>
#include <string.h>

#include <zephyr/bluetooth/bluetooth.h>
#include <zephyr/bluetooth/conn.h>
#include <zephyr/bluetooth/gap.h>
#include <zephyr/bluetooth/gatt.h>
#include <zephyr/bluetooth/hci.h>
#include <zephyr/sys/util.h>
#include <zephyr/kernel.h>
#include <zephyr/logging/log.h>
#include <zephyr/settings/settings.h>

#include "common_include.h"
#include "led.h"
#include "output.h"

LOG_MODULE_DECLARE(network_base);

#define DSA_MANUFACTURER_PAYLOAD_LEN 3
#define DSA_ATT_PAYLOAD_OVERHEAD 3U
#define DSA_CONN_INTERVAL_MIN 6U
#define DSA_CONN_INTERVAL_MAX 12U
#define DSA_CONN_LATENCY 0U
#define DSA_CONN_TIMEOUT 400U
#define DSA_FINISH_DISCONNECT_DELAY K_MSEC(50)

/* Build-time allow-list of beacon names. Leave empty to accept any name. */
static const char * const dsa_allowed_adv_names[] = {
	//"DSA",
	"DSL",
};

/* CONFIG_DSA_TARGET_BEACON_ID == DSA_TARGET_BEACON_ID_ANY accepts any id. */
#define DSA_TARGET_BEACON_ID_ANY 0xFF

struct dsa_adv {
	bool name_match;
	bool manufacturer_match;
	uint8_t id;
	uint8_t radio_status;
	uint8_t network_status;
};

static struct bt_conn *default_conn;
static struct radio_callbacks radio_cb;
static bool scanning_requested;
static bool stop_after_finished_requested;
static bool connect_in_progress;
static bool waiting_for_output_drain;
static bool nus_ready_notified;
static bool transfer_finish_pending;
static uint8_t pending_beacon_id;
static uint8_t pending_beacon_status;
static uint8_t connected_beacon_id;
static uint8_t connected_beacon_status;
static uint8_t readout_level_threshold = CONFIG_DSA_READOUT_LEVEL;
static const struct bt_le_conn_param dsa_conn_param =
	BT_LE_CONN_PARAM_INIT(DSA_CONN_INTERVAL_MIN, DSA_CONN_INTERVAL_MAX,
			      DSA_CONN_LATENCY, DSA_CONN_TIMEOUT);
static struct k_work_delayable finish_disconnect_work;

static int start_scanning(void);

static const char *phy_to_str(uint8_t phy)
{
	switch (phy) {
	case BT_GAP_LE_PHY_1M:
		return "1M";
	case BT_GAP_LE_PHY_2M:
		return "2M";
	case BT_GAP_LE_PHY_CODED:
		return "coded";
	default:
		return "unknown";
	}
}

static void log_conn_throughput_state(struct bt_conn *conn, const char *stage)
{
	struct bt_conn_info info;
	uint16_t att_mtu;
	uint16_t att_payload;
	int err;

	err = bt_conn_get_info(conn, &info);
	if (err) {
		LOG_WRN("%s: failed to read connection info (err %d)", stage, err);
		return;
	}

	att_mtu = bt_gatt_get_mtu(conn);
	att_payload = att_mtu > DSA_ATT_PAYLOAD_OVERHEAD ?
		      att_mtu - DSA_ATT_PAYLOAD_OVERHEAD : 0U;

	LOG_INF("%s: ATT MTU=%u payload=%u cfg L2CAP_TX_MTU=%d ACL_TX_SIZE=%d ACL_RX_SIZE=%d",
		stage, att_mtu, att_payload,
		CONFIG_BT_L2CAP_TX_MTU, CONFIG_BT_BUF_ACL_TX_SIZE,
		CONFIG_BT_BUF_ACL_RX_SIZE);

	if (info.type != BT_CONN_TYPE_LE) {
		LOG_INF("%s: non-LE connection type=%u", stage, info.type);
		return;
	}

	LOG_INF("%s: role=%s interval=%u us latency=%u timeout=%u ms security=L%u",
		stage,
		info.role == BT_CONN_ROLE_CENTRAL ? "central" : "peripheral",
		info.le.interval_us, info.le.latency, info.le.timeout * 10U,
		info.security.level);

#if defined(CONFIG_BT_USER_PHY_UPDATE)
	if (info.le.phy) {
		LOG_INF("%s: PHY tx=%s(0x%02x) rx=%s(0x%02x)", stage,
			phy_to_str(info.le.phy->tx_phy), info.le.phy->tx_phy,
			phy_to_str(info.le.phy->rx_phy), info.le.phy->rx_phy);
	} else {
		LOG_INF("%s: PHY info unavailable", stage);
	}
#endif

#if defined(CONFIG_BT_USER_DATA_LEN_UPDATE)
	if (info.le.data_len) {
		LOG_INF("%s: data length tx=%u/%u us rx=%u/%u us", stage,
			info.le.data_len->tx_max_len,
			info.le.data_len->tx_max_time,
			info.le.data_len->rx_max_len,
			info.le.data_len->rx_max_time);
	} else {
		LOG_INF("%s: data length info unavailable", stage);
	}
#endif
}

static void request_link_throughput_updates(struct bt_conn *conn)
{
	int err;

#if defined(CONFIG_BT_USER_DATA_LEN_UPDATE)
	err = bt_conn_le_data_len_update(conn, BT_LE_DATA_LEN_PARAM_MAX);
	if (err) {
		LOG_WRN("LE data length update request failed (err %d)", err);
	} else {
		LOG_INF("LE data length update requested: tx_len=%u tx_time=%u us",
			BT_GAP_DATA_LEN_MAX, BT_GAP_DATA_TIME_MAX);
	}
#else
	LOG_INF("LE data length update not requested; CONFIG_BT_USER_DATA_LEN_UPDATE=n");
#endif

#if defined(CONFIG_BT_USER_PHY_UPDATE)
	err = bt_conn_le_phy_update(conn, BT_CONN_LE_PHY_PARAM_2M);
	if (err) {
		LOG_WRN("LE 2M PHY update request failed (err %d)", err);
	} else {
		LOG_INF("LE 2M PHY update requested");
	}
#else
	LOG_INF("LE PHY update not requested; CONFIG_BT_USER_PHY_UPDATE=n");
#endif
}

static void finish_disconnect_handler(struct k_work *work)
{
	int err;

	ARG_UNUSED(work);

	if (!default_conn) {
		transfer_finish_pending = false;
		if (stop_after_finished_requested) {
			(void)radio_stop_scanning();
		}
		return;
	}

	log_conn_throughput_state(default_conn, "Disconnect request");

	err = bt_conn_disconnect(default_conn, BT_HCI_ERR_REMOTE_USER_TERM_CONN);
	if (err) {
		LOG_WRN("Disconnect request failed (err %d)", err);
		transfer_finish_pending = false;
	}
}

static bool adv_name_allowed(const uint8_t *data, uint8_t len)
{
	if (ARRAY_SIZE(dsa_allowed_adv_names) == 0) {
		return true;
	}

	for (size_t i = 0; i < ARRAY_SIZE(dsa_allowed_adv_names); i++) {
		const char *name = dsa_allowed_adv_names[i];

		if ((len == strlen(name)) && (memcmp(data, name, len) == 0)) {
			return true;
		}
	}

	return false;
}

static bool adv_id_allowed(uint8_t id)
{
	if (CONFIG_DSA_TARGET_BEACON_ID == DSA_TARGET_BEACON_ID_ANY) {
		return true;
	}

	return id == CONFIG_DSA_TARGET_BEACON_ID;
}

static bool parse_advertising_data(struct bt_data *data, void *user_data)
{
	struct dsa_adv *adv = user_data;

	switch (data->type) {
	case BT_DATA_NAME_COMPLETE:
	case BT_DATA_NAME_SHORTENED:
		if (adv_name_allowed(data->data, data->data_len)) {
			adv->name_match = true;
		}
		break;

	case BT_DATA_MANUFACTURER_DATA:
		if (data->data_len == DSA_MANUFACTURER_PAYLOAD_LEN) {
			adv->id = data->data[ADV_POS_ID];
			adv->radio_status = data->data[ADV_POS_RADIO_STATUS];
			adv->network_status = data->data[ADV_POS_NETWORK_STATUS];
			adv->manufacturer_match = true;
		}
		break;

	default:
		break;
	}

	return true;
}

static bool should_connect_to_adv(const struct dsa_adv *adv)
{
	uint8_t readout_level =
		(adv->network_status & DATA_LEVEL_MASK) >> P_SHIFT_STATUS_DATA;

	return adv->name_match && adv->manufacturer_match &&
	       (readout_level >= readout_level_threshold) &&
	       adv_id_allowed(adv->id);
}

static void scan_recv(const struct bt_le_scan_recv_info *info,
		      struct net_buf_simple *ad)
{
	int err;
	struct dsa_adv adv = { 0 };
	char addr[BT_ADDR_LE_STR_LEN];
	struct net_buf_simple ad_copy = *ad;

	if (default_conn || connect_in_progress || stop_after_finished_requested) {
		return;
	}

	bt_data_parse(&ad_copy, parse_advertising_data, &adv);

	if (adv.name_match && adv.manufacturer_match) {
		LOG_INF("DSA beacon detected: id=%u", adv.id);
	}

	if (!should_connect_to_adv(&adv)) {
		return;
	}

	if (!output_queue_is_drained()) {
		/* Don't connect to the next beacon while the previous one's
		 * output backlog is still draining - a new connection's
		 * earliest notifications (including its Current Timer
		 * preamble, which isn't ack/retried like DATA is - see
		 * nus.c) would compete with that backlog for the same
		 * limited queue slots and risk being dropped under load. The
		 * beacon keeps advertising, so scan_recv() will simply be
		 * called again shortly once the queue clears.
		 */
		if (!waiting_for_output_drain) {
			LOG_INF("Deferring connection to beacon id=%u until output queue drains",
				adv.id);
			waiting_for_output_drain = true;
		}
		return;
	}
	waiting_for_output_drain = false;

	bt_addr_le_to_str(info->addr, addr, sizeof(addr));
	LOG_INF("DSA beacon matched: addr=%s id=%u radio=0x%02x network=0x%02x",
		addr, adv.id, adv.radio_status, adv.network_status);

	err = bt_le_scan_stop();
	if (err && err != -EALREADY) {
		LOG_WRN("Failed to stop scan before connect (err %d)", err);
		return;
	}

	led_set_scanning(false);
	connect_in_progress = true;
	pending_beacon_id = adv.id;
	pending_beacon_status = adv.radio_status;

	LOG_INF("Creating connection with interval=%u-%u (%u-%u us) latency=%u timeout=%u ms",
		dsa_conn_param.interval_min, dsa_conn_param.interval_max,
		BT_CONN_INTERVAL_TO_US(dsa_conn_param.interval_min),
		BT_CONN_INTERVAL_TO_US(dsa_conn_param.interval_max),
		dsa_conn_param.latency, dsa_conn_param.timeout * 10U);

	err = bt_conn_le_create(info->addr, BT_CONN_LE_CREATE_CONN, &dsa_conn_param,
				&default_conn);
	if (err) {
		LOG_WRN("Failed to create connection (err %d)", err);
		default_conn = NULL;
		connect_in_progress = false;

		if (!stop_after_finished_requested) {
			(void)start_scanning();
		}
	}
}

static struct bt_le_scan_cb scan_callbacks = {
	.recv = scan_recv,
};

static void notify_ready_for_nus(struct bt_conn *conn)
{
	if ((default_conn != conn) || nus_ready_notified) {
		return;
	}

	nus_ready_notified = true;
	log_conn_throughput_state(conn, "NUS start");

	if (radio_cb.connected) {
		radio_cb.connected(conn, connected_beacon_id, connected_beacon_status);
	}
}

static void exchange_func(struct bt_conn *conn, uint8_t err,
			  struct bt_gatt_exchange_params *params)
{
	ARG_UNUSED(params);

	if (err) {
		LOG_WRN("MTU exchange failed (err %u)", err);
	} else {
		LOG_INF("MTU exchange complete");
	}

	log_conn_throughput_state(conn, "MTU exchange callback");
	notify_ready_for_nus(conn);
}

static bool le_param_req(struct bt_conn *conn, struct bt_le_conn_param *param)
{
	LOG_WRN("LE parameter request rejected: min=%u (%u us) max=%u (%u us) latency=%u timeout=%u ms",
		param->interval_min, BT_CONN_INTERVAL_TO_US(param->interval_min),
		param->interval_max, BT_CONN_INTERVAL_TO_US(param->interval_max),
		param->latency, param->timeout * 10U);
	log_conn_throughput_state(conn, "LE parameter request");

	return false;
}

static void le_param_updated(struct bt_conn *conn, uint16_t interval,
			     uint16_t latency, uint16_t timeout)
{
	LOG_INF("LE parameters updated: interval=%u (%u us) latency=%u timeout=%u ms",
		interval, BT_CONN_INTERVAL_TO_US(interval), latency,
		timeout * 10U);
	log_conn_throughput_state(conn, "LE parameter callback");
}

#if defined(CONFIG_BT_USER_PHY_UPDATE)
static void le_phy_updated(struct bt_conn *conn,
			   struct bt_conn_le_phy_info *param)
{
	LOG_INF("LE PHY updated: tx=%s(0x%02x) rx=%s(0x%02x)",
		phy_to_str(param->tx_phy), param->tx_phy,
		phy_to_str(param->rx_phy), param->rx_phy);
	log_conn_throughput_state(conn, "LE PHY callback");
}
#endif

#if defined(CONFIG_BT_USER_DATA_LEN_UPDATE)
static void le_data_len_updated(struct bt_conn *conn,
				struct bt_conn_le_data_len_info *info)
{
	LOG_INF("LE data length updated: tx=%u/%u us rx=%u/%u us",
		info->tx_max_len, info->tx_max_time, info->rx_max_len,
		info->rx_max_time);
	log_conn_throughput_state(conn, "LE data length callback");
}
#endif

static void connected(struct bt_conn *conn, uint8_t conn_err)
{
	char addr[BT_ADDR_LE_STR_LEN];
	static struct bt_gatt_exchange_params exchange_params;
	int err;

	bt_addr_le_to_str(bt_conn_get_dst(conn), addr, sizeof(addr));
	connect_in_progress = false;

	if (conn_err) {
		LOG_WRN("Connection failed: %s err 0x%02x %s", addr, conn_err,
			bt_hci_err_to_str(conn_err));

		if (default_conn == conn) {
			bt_conn_unref(default_conn);
			default_conn = NULL;
		}

		if (!stop_after_finished_requested) {
			(void)start_scanning();
		}

		return;
	}

	if (!default_conn) {
		default_conn = bt_conn_ref(conn);
	}

	LOG_INF("Connected: %s", addr);
	led_set_connected(true);
	connected_beacon_id = pending_beacon_id;
	connected_beacon_status = pending_beacon_status;
	nus_ready_notified = false;
	log_conn_throughput_state(conn, "Connected initial");
	request_link_throughput_updates(conn);

	exchange_params.func = exchange_func;
	LOG_INF("Requesting ATT MTU exchange");
	err = bt_gatt_exchange_mtu(conn, &exchange_params);
	if (err) {
		LOG_WRN("MTU exchange request failed (err %d)", err);
		log_conn_throughput_state(conn, "MTU exchange request failed");
		notify_ready_for_nus(conn);
	}
}

static void disconnected(struct bt_conn *conn, uint8_t reason)
{
	char addr[BT_ADDR_LE_STR_LEN];

	bt_addr_le_to_str(bt_conn_get_dst(conn), addr, sizeof(addr));
	LOG_INF("Disconnected: %s reason 0x%02x %s", addr, reason,
		bt_hci_err_to_str(reason));

	if (default_conn == conn) {
		bt_conn_unref(default_conn);
		default_conn = NULL;
	}

	connect_in_progress = false;
	nus_ready_notified = false;
	transfer_finish_pending = false;
	(void)k_work_cancel_delayable(&finish_disconnect_work);
	led_set_connected(false);

	if (radio_cb.disconnected) {
		radio_cb.disconnected();
	}

	if (stop_after_finished_requested) {
		scanning_requested = false;
		led_set_scanning(false);
		return;
	}

	if (scanning_requested) {
		LOG_INF("Restarting scan after disconnect");
		(void)start_scanning();
	}
}

BT_CONN_CB_DEFINE(conn_callbacks) = {
	.connected = connected,
	.disconnected = disconnected,
	.le_param_req = le_param_req,
	.le_param_updated = le_param_updated,
#if defined(CONFIG_BT_USER_PHY_UPDATE)
	.le_phy_updated = le_phy_updated,
#endif
#if defined(CONFIG_BT_USER_DATA_LEN_UPDATE)
	.le_data_len_updated = le_data_len_updated,
#endif
};

int radio_init(const struct radio_callbacks *callbacks)
{
	int err;

	if (callbacks) {
		radio_cb = *callbacks;
	}

	k_work_init_delayable(&finish_disconnect_work, finish_disconnect_handler);
	bt_le_scan_cb_register(&scan_callbacks);

	err = bt_enable(NULL);
	if (err) {
		LOG_ERR("Bluetooth init failed (err %d)", err);
		return err;
	}

	LOG_INF("Bluetooth initialized");

	if (IS_ENABLED(CONFIG_SETTINGS)) {
		err = settings_load();
		if (err) {
			LOG_WRN("Settings load failed (err %d)", err);
		}
	}

	return 0;
}

static int start_scanning(void)
{
	int err;

	stop_after_finished_requested = false;
	scanning_requested = true;

	if (default_conn || connect_in_progress) {
		LOG_INF("Scan requested; waiting for current connection state");
		return 0;
	}

	err = bt_le_scan_start(BT_LE_SCAN_ACTIVE, NULL);
	if (err == -EALREADY) {
		led_set_scanning(true);
		LOG_INF("Scanning already active");
		return 0;
	}
	if (err) {
		LOG_ERR("Scanning failed to start (err %d)", err);
		return err;
	}

	led_set_scanning(true);
	LOG_INF("Scan started");
	return 0;
}

int radio_start_scanning_with_level(uint8_t min_data_level)
{
	readout_level_threshold = min_data_level;
	LOG_INF("Scan requested with minimum data level %u", min_data_level);
	return start_scanning();
}

int radio_stop_scanning(void)
{
	int err;

	scanning_requested = false;
	err = bt_le_scan_stop();
	if (err && err != -EALREADY) {
		LOG_ERR("Failed to stop scanning (err %d)", err);
		return err;
	}

	led_set_scanning(false);
	LOG_INF("Scan stopped");
	return 0;
}

void radio_request_stop_after_finished(void)
{
	stop_after_finished_requested = true;
	scanning_requested = false;

	if (!default_conn && !connect_in_progress) {
		(void)radio_stop_scanning();
		LOG_INF("Stop requested with no active connection");
		return;
	}

	(void)bt_le_scan_stop();
	led_set_scanning(false);
	LOG_INF("Stop requested; waiting for current transfer to finish");
}

void radio_transfer_finished(void)
{
	LOG_INF("Transfer finished");

	if (transfer_finish_pending) {
		LOG_INF("Disconnect already pending after transfer finished");
		return;
	}

	transfer_finish_pending = true;

	if (!default_conn) {
		transfer_finish_pending = false;
		if (stop_after_finished_requested) {
			(void)radio_stop_scanning();
		}
		return;
	}

	LOG_INF("Scheduling disconnect after transfer finished");
	k_work_schedule(&finish_disconnect_work, DSA_FINISH_DISCONNECT_DELAY);
}
```

## src/radio.h
```c
#ifndef RADIO_H_
#define RADIO_H_

#include <stdbool.h>
#include <stdint.h>

#include <zephyr/bluetooth/conn.h>

typedef void (*radio_connected_cb_t)(struct bt_conn *conn, uint8_t beacon_id,
				     uint8_t status);
typedef void (*radio_disconnected_cb_t)(void);

struct radio_callbacks {
	radio_connected_cb_t connected;
	radio_disconnected_cb_t disconnected;
};

int radio_init(const struct radio_callbacks *callbacks);
int radio_start_scanning_with_level(uint8_t min_data_level);
int radio_stop_scanning(void);
void radio_request_stop_after_finished(void);
void radio_transfer_finished(void);

#endif /* RADIO_H_ */
```

## src/rtt_output.c
```c
#include "rtt_output.h"

#include <stdbool.h>
#include <stddef.h>
#include <stdint.h>

#include <SEGGER_RTT.h>
#include <zephyr/kernel.h>

#define RTT_OUTPUT_MESSAGE_GAP K_MSEC(5)

int rtt_output_init(void)
{
	SEGGER_RTT_Init();
	SEGGER_RTT_ConfigUpBuffer(0, "Terminal", NULL, 0,
				  SEGGER_RTT_MODE_BLOCK_IF_FIFO_FULL);

	return 0;
}

void rtt_output_message(const char *message)
{
	bool ends_with_newline = false;

	for (const char *p = message; *p != '\0'; p++) {
		ends_with_newline = (*p == '\n');

		if (*p == '\n') {
			SEGGER_RTT_PutChar(0, '\r');
		}

		SEGGER_RTT_PutChar(0, *p);
	}

	if (!ends_with_newline) {
		SEGGER_RTT_WriteString(0, "\r\n");
	}

	k_sleep(RTT_OUTPUT_MESSAGE_GAP);
}

void rtt_output_data(const uint8_t *data, size_t len)
{
	SEGGER_RTT_Write(0, data, len);
	k_sleep(RTT_OUTPUT_MESSAGE_GAP);
}
```

## src/rtt_output.h
```c
#ifndef RTT_OUTPUT_H_
#define RTT_OUTPUT_H_

#include <stddef.h>
#include <stdint.h>

int rtt_output_init(void);
void rtt_output_data(const uint8_t *data, size_t len);
void rtt_output_message(const char *message);

#endif /* RTT_OUTPUT_H_ */
```
