## Testsuite/2_Implementation/firmware_target/flash_ring_store_target/testcase.yaml
```yaml
tests:
  dsa.flash_ring_store.target:
    platform_allow:
      - nrf54l15dk/nrf54l15/cpuapp/ns
    tags: dsa storage
    harness: ztest
```
