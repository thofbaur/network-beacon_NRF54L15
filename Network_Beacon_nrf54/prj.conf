## CMakeLists.txt
```
# SPDX-License-Identifier: Apache-2.0

cmake_minimum_required(VERSION 3.20.0)

list(APPEND EXTRA_CONF_FILE
    "${CMAKE_CURRENT_SOURCE_DIR}/dsa.conf"
    "${CMAKE_CURRENT_SOURCE_DIR}/dsa_runtime.conf"
)

# The onboard ADXL367 (motion.c) only exists on the nrf54l15tag board. Its
# interrupt GPIO isn't wired by the board's own devicetree, so add it here
# explicitly rather than relying on boards/<board>.overlay auto-discovery,
# which Zephyr caches at first configure and won't re-check afterward.
if(BOARD STREQUAL "nrf54l15tag/nrf54l15/cpuapp/ns" OR
   BOARD STREQUAL "nrf54l15tag/nrf54l15/cpuapp")
    list(APPEND EXTRA_DTC_OVERLAY_FILE
        "${CMAKE_CURRENT_SOURCE_DIR}/boards/nrf54l15tag_nrf54l15_cpuapp_ns.overlay"
    )
endif()

find_package(Zephyr REQUIRED HINTS $ENV{ZEPHYR_BASE})
project(scan_adv)

target_include_directories(app PRIVATE ${CMAKE_CURRENT_SOURCE_DIR}/../shared)

target_sources(app PRIVATE
	src/battery_voltage.c
	src/device.c
	src/eco_log.c
	src/eco_log_storage.c
	src/flash_ring_store.c
	src/led.c
	src/main.c
	src/motion.c
	src/network.c
	src/network_storage.c
	src/nus.c
	src/param_storage.c
	src/radio.c
	src/radio_ids.c
	src/ram_log_ring.c
	src/self_report.c
	src/self_report_storage.c
	src/storage_work_queue.c
)

target_sources_ifdef(CONFIG_DSA_DEV_VALIDATION app PRIVATE
	src/development_validation.c
)

zephyr_library_include_directories(${ZEPHYR_BASE}/samples/bluetooth)
```

## Kconfig
```
mainmenu "DSA Network Beacon"

source "Kconfig.zephyr"

menu "DSA development options"

config DSA_DEV_VALIDATION
	bool
	default y if DSA_DEV_SYNTHETIC_CONTACTS
	default y if DSA_DEV_SYNTHETIC_SELF_REPORTS

config DSA_DEV_SYNTHETIC_CONTACTS
	bool "Insert synthetic contacts at startup"
	default n
	help
	  Build the development contact generator and insert synthetic contacts
	  at startup. Keep this disabled for production firmware.

config DSA_DEV_SYNTHETIC_CONTACT_COUNT
	int "Synthetic contacts inserted at startup"
	default 100
	range 0 65535
	help
	  Number of synthetic contacts inserted at startup when development
	  contact generation is enabled. Ignored when synthetic contacts are
	  disabled.

config DSA_DEV_SYNTHETIC_SELF_REPORTS
	bool "Insert synthetic self reports at startup"
	default n
	help
	  Build the development self-report generator and insert synthetic
	  self reports at startup. Keep this disabled for production firmware.

config DSA_DEV_SYNTHETIC_SELF_REPORT_COUNT
	int "Synthetic self reports inserted at startup"
	default 0
	range 0 65535
	help
	  Number of synthetic self reports inserted at startup when development
	  self-report generation is enabled. Ignored when synthetic self reports
	  are disabled.

config DSA_DEV_ECO_LED_INDICATOR
	bool "Light a solid LED during energy conservation mode"
	default n
	help
	  Keep an LED lit instead of off while inactivity detection has put
	  the device into energy conservation mode, so the mode is visible
	  during development. This works against the point of energy
	  conservation by keeping an LED powered. Keep this disabled for
	  production firmware.

endmenu

menu "DSA LED behavior"

config DSA_DEFAULT_LED_ACTIVE
	bool "Enable status LED blinking by default"
	default n

config DSA_LED_BLINK_INTERVAL_MS
	int "Default status LED blink interval in milliseconds"
	default 20000
	range 1000 65535000

config DSA_LED_BLINK_ON_MS
	int "Status LED on-time in milliseconds"
	default 30
	range 1 60000

config DSA_SELF_REPORT_LED_ON_MS
	int "Self-report LED on-time in milliseconds"
	default 2000
	range 1 60000

config DSA_DEFAULT_FIREWORK_ACTIVE
	bool "Enable the firework LED effect by default"
	default n
	help
	  When active, all available LEDs flicker randomly instead of their
	  normal jobs (status blink, self-report flash, eco indicator).
	  Intended as an explicitly-triggered visual effect (e.g. to locate a
	  specific physical tag), not a normal operating mode.

config DSA_FIREWORK_INTERVAL_MIN_MS
	int "Firework effect minimum LED on-time in milliseconds"
	default 60
	range 1 60000

config DSA_FIREWORK_INTERVAL_MAX_MS
	int "Firework effect maximum LED on-time in milliseconds"
	default 250
	range 1 60000

endmenu

menu "DSA network buffering"

config DSA_NETWORK_RING_COUNT
	int "Contact entries held in RAM"
	default 24000
	range 1 65535

config DSA_NETWORK_DEFAULT_RSSI_THRESHOLD
	int "Default RSSI magnitude threshold"
	default 80
	range 0 255

config DSA_NETWORK_DEFAULT_RSSI_THRESHOLD_LOCATION
	int "Default RSSI magnitude threshold for DSL location tags"
	default 100
	range 0 255
	help
	  Location tags (advertised name "DSL") are stationary and use a
	  separate, looser threshold than moving person-worn beacons (DSA/
	  DST), since interaction distance for a fixed location doesn't need
	  the same precision. Magnitude only: 100 means -100 dBm.

config DSA_NETWORK_DEFAULT_TRACKING_ACTIVE
	bool "Enable contact tracking by default"
	default y

config DSA_NETWORK_STATUS_UPDATE_DELAY_MS
	int "Contact status update delay in milliseconds"
	default 300
	range 0 60000

config DSA_NETWORK_FLUSH_THRESHOLD
	int "RAM contact count that starts flash flushing"
	default 23700
	range 1 65535

config DSA_NETWORK_FLASH_SIZE_BYTES
	hex "Contact flash partition size in bytes"
	default 0xf1000
	help
	  Must match contact_storage's size in pm_static.yml. Bounded by
	  nRF54L15's real usable flash (0x165000, after FLPR and TF-M's NS
	  storage reservations) minus the fixed 2-sector NVS minimum each for
	  self_report_storage, settings_storage, and eco_log_storage, minus
	  the tfm/app firmware image partitions (each right-sized to actual
	  usage plus ~25 kB growth headroom - see pm_static.yml).

endmenu

menu "DSA battery monitoring"

config DSA_BATTERY_MEASURE_INTERVAL_MS
	int "Battery voltage measurement interval in milliseconds"
	default 14400000
	range 1000 86400000
	help
	  Delay between periodic battery voltage measurements. The default is
	  four hours.

endmenu

menu "DSA radio timing"

config DSA_ADV_INTERVAL_MIN_MS
	int "High-activity minimum advertising interval in milliseconds"
	default 90
	range 20 10240

config DSA_ADV_INTERVAL_MAX_MS
	int "High-activity maximum advertising interval in milliseconds"
	default 120
	range 20 10240

config DSA_SCAN_WINDOW_MS
	int "High-activity scan window in milliseconds"
	default 120
	range 3 10240

config DSA_SCAN_INTERVAL_MS
	int "High-activity scan interval in milliseconds"
	default 7000
	range 3 10240

config DSA_ECO_ADV_INTERVAL_MIN_MS
	int "Energy-conservation minimum advertising interval in milliseconds"
	default 90
	range 20 10240
	help
	  Advertising is not reduced in energy conservation mode by default;
	  this matches the high-activity interval but can be changed
	  independently later.

config DSA_ECO_ADV_INTERVAL_MAX_MS
	int "Energy-conservation maximum advertising interval in milliseconds"
	default 120
	range 20 10240

config DSA_ECO_SCAN_WINDOW_MS
	int "Energy-conservation scan burst duration in milliseconds"
	default 100
	range 3 10240
	help
	  How long each periodic scan burst listens for, while inactivity
	  detection has the device in energy conservation mode.

config DSA_RADIO_DEFAULT_HIGH_ACTIVITY
	bool "Start in high-activity radio mode by default"
	default y

config DSA_ECO_SCAN_INTERVAL_MS
	int "Energy-conservation scan burst period in milliseconds"
	default 300000
	range 1000 3600000
	help
	  Period between scan bursts while inactivity detection has the
	  device in energy conservation mode. Advertising keeps its own
	  (usually normal-rate) interval in this mode; only scanning is
	  duty-cycled. This value exceeds what the BLE scan-interval field
	  can express (max ~10.24 s), so it is implemented as periodic
	  application-triggered scan bursts (each DSA_ECO_SCAN_WINDOW_MS
	  long) rather than a single scan parameter.

endmenu

menu "DSA NUS transport"

config DSA_NUS_IDLE_TIMEOUT_MS
	int "NUS connection idle timeout in milliseconds"
	default 5000
	range 1000 600000

endmenu

menu "DSA inactivity detection"

config DSA_MOTION_DEFAULT_ACTIVE
	bool "Enable inactivity-based energy conservation by default"
	default y

config DSA_MOTION_INACTIVITY_TIMEOUT_S
	int "Default inactivity timeout before energy conservation mode, in seconds"
	default 3600
	range 1 65535

endmenu

menu "DSA eco log storage"

config DSA_ECO_LOG_RING_COUNT
	int "Eco session entries held in RAM"
	default 64
	range 1 65535

config DSA_ECO_LOG_FLUSH_THRESHOLD
	int "Eco log RAM flush threshold"
	default 63
	range 2 65535
	help
	  Start moving the oldest eco sessions to flash when this many
	  sessions are buffered in RAM.

config DSA_ECO_LOG_FLASH_SIZE_BYTES
	hex "Eco log flash partition size in bytes"
	default 0x2000
	help
	  Size of the fixed flash partition reserved for the eco log. The
	  partition must contain at least two complete flash sectors.

config DSA_ECO_LOG_FLUSH_BATCH
	int "Eco sessions written per flash block"
	default 16
	range 1 64

config DSA_ECO_LOG_FLUSH_RETRY_MS
	int "Eco log flash retry delay in milliseconds"
	default 5000
	range 100 60000
	help
	  Delay before retrying a failed eco log flash write.

endmenu

menu "DSA self-report storage"

config DSA_SELF_REPORT_LONG_PRESS_MS
	int "Button hold time required for a self report"
	default 3000
	range 100 60000

config DSA_SELF_REPORT_RING_COUNT
	int "Self-report entries held in RAM"
	default 256
	range 1 65535

config DSA_SELF_REPORT_FLUSH_THRESHOLD
	int "Self-report RAM flush threshold"
	default 254
	range 2 65535
	help
	  Start moving the oldest reports to flash when this many reports
	  are buffered in RAM.

config DSA_SELF_REPORT_FLASH_SIZE_BYTES
	hex "Self-report flash partition size in bytes"
	default 0x2000
	help
	  Size of the fixed flash partition reserved for self reports. The
	  partition must contain at least two complete flash sectors.

config DSA_SELF_REPORT_FLUSH_BATCH
	int "Reports written per flash block"
	default 64
	range 1 64
	help
	  Number of oldest RAM reports reserved for each flash write.

config DSA_SELF_REPORT_FLUSH_RETRY_MS
	int "Self-report flash retry delay in milliseconds"
	default 5000
	range 100 60000
	help
	  Delay before retrying a failed self-report flash write.

endmenu
```

## prj.conf
```kconfig
CONFIG_BT=y
CONFIG_BT_BROADCASTER=y
CONFIG_BT_OBSERVER=y
CONFIG_BT_PERIPHERAL=y
CONFIG_BT_GATT_CLIENT=y
CONFIG_BT_MAX_CONN=1
CONFIG_BT_NUS=y
CONFIG_BT_USER_DATA_LEN_UPDATE=y
CONFIG_BT_USER_PHY_UPDATE=y
CONFIG_BT_GAP_AUTO_UPDATE_CONN_PARAMS=n
CONFIG_BT_BUF_ACL_RX_SIZE=251
CONFIG_BT_ATT_TX_COUNT=10
CONFIG_BT_L2CAP_TX_MTU=498
CONFIG_BT_CONN_TX_MAX=10
CONFIG_BT_BUF_EVT_RX_COUNT=11
CONFIG_BT_BUF_ACL_TX_COUNT=10
CONFIG_BT_BUF_ACL_TX_SIZE=502
CONFIG_BT_CTLR_DATA_LENGTH_MAX=251
CONFIG_BT_CTLR_PHY_2M=y
# Disabled for production: the advertised status byte (device.h/
# common_include.h, redesigned 2026-08-09 - see DECISIONS.md) is the
# diagnostic channel for a fielded tag, not the console. Re-enable all four
# for bench debugging if needed.
CONFIG_LOG=n
CONFIG_PRINTK=n
CONFIG_CONSOLE=n
CONFIG_UART_CONSOLE=n
CONFIG_BT_FILTER_ACCEPT_LIST=y
# Requested size 256; the SoftDevice Controller's BT_CTLR_FAL_SIZE field
# range is "0 255", so 255 is the actual maximum.
CONFIG_BT_CTLR_FAL_SIZE=255
CONFIG_ADC=y
CONFIG_GPIO=y
CONFIG_FLASH=y
CONFIG_FLASH_MAP=y
CONFIG_NVS=y
CONFIG_SETTINGS=y
CONFIG_SETTINGS_NVS=y
CONFIG_SETTINGS_NVS_SECTOR_COUNT=2
CONFIG_PM_PARTITION_SIZE_SETTINGS_STORAGE=0x2000
# nRF54L15 has no Zephyr system-PM implementation. Device PM and tickless
# kernel idle are the supported low-power mechanisms for this target.
CONFIG_PM_DEVICE=y
CONFIG_TICKLESS_KERNEL=y

# ADXL367 motion sensor for inactivity detection. Only present on the
# nrf54l15tag board; motion.c degrades gracefully when it's absent (e.g.
# the plain nrf54l15dk used for bench debugging).
CONFIG_SENSOR=y
CONFIG_ADXL367_TRIGGER_GLOBAL_THREAD=y
CONFIG_ADXL367_INACTIVITY_DETECTION_MODE=n
# The nrf54l15tag board also carries a BME680 and BMI270 that CONFIG_SENSOR
# auto-enables by default; this firmware doesn't use either.
CONFIG_BME680=n
CONFIG_BMI270=n
```

## dsa.conf
```kconfig
# DSA project-specific build configuration.

# Development-only synthetic data generation lives in dsa_dev.conf and is
# not included here. Add it explicitly for test builds only, e.g.:
#   west build ... -- -DEXTRA_CONF_FILE="dsa_dev.conf"

CONFIG_BT_DEVICE_NAME="DSA"
# Choice symbol, not a plain int - pick the CONFIG_BT_CTLR_TX_PWR_<level>
# matching the desired dBm (see subsys/bluetooth/controller/Kconfig for the
# full list of levels the SoC supports). 0 dBm is also Zephyr's own default
# for this choice, so this pins it explicitly rather than changing it.
CONFIG_BT_CTLR_TX_PWR_0=y
#CONFIG_BT_CTLR_TX_PWR_PLUS_8=y

CONFIG_DSA_LED_BLINK_ON_MS=30
CONFIG_DSA_SELF_REPORT_LED_ON_MS=2000
CONFIG_DSA_FIREWORK_INTERVAL_MIN_MS=60
CONFIG_DSA_FIREWORK_INTERVAL_MAX_MS=250

CONFIG_DSA_NETWORK_RING_COUNT=24000
CONFIG_DSA_NETWORK_STATUS_UPDATE_DELAY_MS=300
# Flush threshold = RAM ring size - 300: leaves headroom to keep accepting
# new contacts while a flush is in flight, without forcing a flush on every
# single contact.
CONFIG_DSA_NETWORK_FLUSH_THRESHOLD=23700
CONFIG_DSA_NETWORK_FLASH_SIZE_BYTES=0xf1000

CONFIG_DSA_NUS_IDLE_TIMEOUT_MS=5000

CONFIG_DSA_SELF_REPORT_LONG_PRESS_MS=3000
CONFIG_DSA_SELF_REPORT_RING_COUNT=256
# Flush threshold = RAM ring size - 2.
CONFIG_DSA_SELF_REPORT_FLUSH_THRESHOLD=254
CONFIG_DSA_SELF_REPORT_FLASH_SIZE_BYTES=0x2000
# Batch = one full flash block (SELF_REPORT_STORAGE_BLOCK_ENTRIES), so each
# flush writes exactly one block with no wasted space.
CONFIG_DSA_SELF_REPORT_FLUSH_BATCH=64
CONFIG_DSA_SELF_REPORT_FLUSH_RETRY_MS=5000

CONFIG_DSA_MOTION_INACTIVITY_TIMEOUT_S=1800

CONFIG_DSA_ECO_LOG_RING_COUNT=64
# Flush threshold = RAM ring size - 1.
CONFIG_DSA_ECO_LOG_FLUSH_THRESHOLD=63
CONFIG_DSA_ECO_LOG_FLASH_SIZE_BYTES=0x2000
# Batch = one full flash block (ECO_LOG_STORAGE_BLOCK_ENTRIES), so each
# flush writes exactly one block with no wasted space.
CONFIG_DSA_ECO_LOG_FLUSH_BATCH=16
CONFIG_DSA_ECO_LOG_FLUSH_RETRY_MS=5000

CONFIG_DSA_DEV_ECO_LED_INDICATOR=n
```

## dsa_dev.conf
```kconfig
# Development-only synthetic data generation for the DSA network beacon.
#
# Not included by the default build (see CMakeLists.txt / dsa.conf). Add
# this as an extra conf file for test builds only, e.g.:
#   west build -b nrf54l15dk/nrf54l15/cpuapp/ns -d build_debug --sysbuild . \
#       -- -DEXTRA_CONF_FILE="dsa_dev.conf"
#
# Do not include this file in production/release builds.

CONFIG_DSA_DEV_SYNTHETIC_CONTACTS=y
CONFIG_DSA_DEV_SYNTHETIC_CONTACT_COUNT=23699

CONFIG_DSA_DEV_SYNTHETIC_SELF_REPORTS=y
CONFIG_DSA_DEV_SYNTHETIC_SELF_REPORT_COUNT=2
```

## dsa_runtime.conf
```kconfig
# Defaults for parameters that can be changed at runtime and persisted.

CONFIG_DSA_DEFAULT_LED_ACTIVE=n
CONFIG_DSA_LED_BLINK_INTERVAL_MS=20000

# Explicitly-triggered visual effect (P_MAIN_FIREWORK_ACTIVE), not a normal
# operating mode - stays off unless a control command turns it on.
CONFIG_DSA_DEFAULT_FIREWORK_ACTIVE=n

# Eco mode has no entry path other than motion.c's inactivity timer, so
# this is the availability switch for eco mode as a whole - not just
# whether the accelerometer is watched. Runtime-controllable via
# P_MOTION_ACTIVE, persisted by motion_params_save()/motion_params_load().
CONFIG_DSA_MOTION_DEFAULT_ACTIVE=n

CONFIG_DSA_NETWORK_DEFAULT_RSSI_THRESHOLD=80
CONFIG_DSA_NETWORK_DEFAULT_RSSI_THRESHOLD_LOCATION=100
CONFIG_DSA_NETWORK_DEFAULT_TRACKING_ACTIVE=y

CONFIG_DSA_ADV_INTERVAL_MIN_MS=90
CONFIG_DSA_ADV_INTERVAL_MAX_MS=120
CONFIG_DSA_SCAN_WINDOW_MS=120
CONFIG_DSA_SCAN_INTERVAL_MS=7000
CONFIG_DSA_ECO_ADV_INTERVAL_MIN_MS=90
CONFIG_DSA_ECO_ADV_INTERVAL_MAX_MS=120
CONFIG_DSA_ECO_SCAN_WINDOW_MS=100
CONFIG_DSA_RADIO_DEFAULT_HIGH_ACTIVITY=y
CONFIG_DSA_ECO_SCAN_INTERVAL_MS=300000
```

## boards/nrf54l15tag_nrf54l15_cpuapp_ns.overlay
```dts
/*
 * Wire up the onboard ADXL367 activity interrupt for inactivity detection.
 * The node itself (bus, address, status) is already provided by the
 * nrf54l15tag board files; this overlay only adds what they leave out.
 *
 * int1-gpios matches Nordic's own Fast Pair locator_tag reference overlay
 * for this exact board (nrf/samples/bluetooth/fast_pair/locator_tag).
 */

/ {
	aliases {
		motion-detector = &adxl367;
	};
};

&adxl367 {
	int1-gpios = <&gpio0 3 0>;
	odr = <1>; /* 25 Hz */

	/*
	 * Zephyr auto-probes this device at POST_KERNEL boot, before the
	 * VDD rail has necessarily settled on a genuine power-cycle (a
	 * debugger-triggered reset never drops that rail, so it never hits
	 * this race). A failed auto-probe is latched permanently - nothing
	 * re-runs it later. Deferring init lets motion_init() poll the chip
	 * live over I2C until it actually responds, then run the one probe
	 * itself - see the MOTION_SENSOR_PROBE_* comment in motion.c.
	 */
	zephyr,deferred-init;
};
```

## src/main.c
```c
/* main.c - Application main entry point */

/*
 * Copyright (c) 2015-2016 Intel Corporation
 *
 * SPDX-License-Identifier: Apache-2.0
 */

#include <zephyr/types.h>
#include <stddef.h>
#include <zephyr/kernel.h>
#include <zephyr/sys/printk.h>
#include <zephyr/sys/util.h>

#include <zephyr/bluetooth/bluetooth.h>

#include "radio.h"
#include "network.h"
#include "led.h"
#include "self_report.h"
#include "battery_voltage.h"
#include "development_validation.h"
#include "motion.h"
#include "eco_log.h"

int main(void)
{
    int err;


	printk("Starting DSA Network Beacon\n");
	led_init();
	err = self_report_init();
	if (err) {
		printk("Self-report subsystem initialization failed (err %d)\n",
		       err);
	}

	err = eco_log_init();
	if (err) {
		printk("Eco log initialization failed (err %d)\n", err);
	}

	err = network_init();
	if (err) {
		printk("Network subsystem initialization failed (err %d)\n", err);
	}
	err = battery_voltage_init();
	if (err) {
		printk("Battery voltage initialization failed (err %d)\n", err);
	}

	/* Initialize the Bluetooth Subsystem */
	err = radio_init();
	if (err) {
		printk("Radio initialization failed (err %d)\n", err);
		return err;
	}

	err = motion_init();
	if (err) {
		printk("Motion subsystem initialization failed (err %d)\n", err);
	}

	/* Start advertising and scanning*/
	err = radio_start();
	if (err) {
		printk("Radio start failed (err %d)\n", err);
		return err;
	}

#if defined(CONFIG_DSA_DEV_SYNTHETIC_CONTACTS)
	development_validation_fill_random_contacts(
		CONFIG_DSA_DEV_SYNTHETIC_CONTACT_COUNT);
#endif

#if defined(CONFIG_DSA_DEV_SYNTHETIC_SELF_REPORTS)
	development_validation_fill_self_reports(
		CONFIG_DSA_DEV_SYNTHETIC_SELF_REPORT_COUNT);
#endif

	k_sleep(K_FOREVER);
	return 0;
}
```

## src/battery_voltage.c
```c
#include <errno.h>
#include <stdint.h>

#include <zephyr/device.h>
#include <zephyr/devicetree.h>
#include <zephyr/drivers/adc.h>
#include <zephyr/dt-bindings/adc/nrf-saadc.h>
#include <zephyr/sys/atomic.h>
#include <zephyr/sys/printk.h>
#include <zephyr/sys/util.h>

#include "battery_voltage.h"
#include "common_include.h"
#include "device.h"

#define BATTERY_ADC_NODE DT_NODELABEL(adc)
#define BATTERY_ADC_CHANNEL 0
#define BATTERY_ADC_REFERENCE_MV 900
#define BATTERY_ADC_RESOLUTION 14
#define BATTERY_ADC_OVERSAMPLING 2

BUILD_ASSERT(BATTERY_LEVEL_1_THRESHOLD_MV > BATTERY_LEVEL_2_THRESHOLD_MV,
	     "Battery status thresholds must be descending");
BUILD_ASSERT(BATTERY_LEVEL_2_THRESHOLD_MV > BATTERY_LEVEL_3_THRESHOLD_MV,
	     "Battery status thresholds must be descending");

static const struct device *const battery_adc =
	DEVICE_DT_GET(BATTERY_ADC_NODE);
static bool battery_adc_ready;
static atomic_t stored_voltage_mv = ATOMIC_INIT(UINT16_MAX);

static int battery_voltage_sample_mv(uint16_t *voltage_mv);
static int battery_voltage_measure_store(void);
static void battery_voltage_measure_handler(struct k_work *work);

static K_WORK_DELAYABLE_DEFINE(battery_voltage_measure_work,
			       battery_voltage_measure_handler);

int battery_voltage_init(void)
{
	const struct adc_channel_cfg channel_cfg = {
		.gain = ADC_GAIN_1_4,
		.reference = ADC_REF_INTERNAL,
		.acquisition_time = ADC_ACQ_TIME_DEFAULT,
		.channel_id = BATTERY_ADC_CHANNEL,
		.differential = false,
		.input_positive = NRF_SAADC_VDD,
	};
	int err;

	if (!device_is_ready(battery_adc)) {
		printk("Battery ADC device not ready\n");
		return -ENODEV;
	}

	err = adc_channel_setup(battery_adc, &channel_cfg);
	if (err) {
		printk("Battery ADC channel setup failed (err %d)\n", err);
		return err;
	}

	battery_adc_ready = true;
	printk("Battery voltage measurement initialized\n");

	err = battery_voltage_measure_store();
	if (err) {
		printk("Initial battery voltage measurement failed (err %d)\n",
		       err);
	}

	k_work_schedule(&battery_voltage_measure_work,
			K_MSEC(CONFIG_DSA_BATTERY_MEASURE_INTERVAL_MS));
	return 0;
}

int battery_voltage_read_mv(uint16_t *voltage_mv)
{
	atomic_val_t stored;

	if (!voltage_mv) {
		return -EINVAL;
	}

	stored = atomic_get(&stored_voltage_mv);
	if (stored == UINT16_MAX) {
		return -ENODATA;
	}

	*voltage_mv = (uint16_t)stored;
	return 0;
}

uint8_t battery_voltage_status_from_mv(uint16_t voltage_mv)
{
	if (voltage_mv < BATTERY_LEVEL_3_THRESHOLD_MV) {
		return 3U;
	}
	if (voltage_mv < BATTERY_LEVEL_2_THRESHOLD_MV) {
		return 2U;
	}
	if (voltage_mv < BATTERY_LEVEL_1_THRESHOLD_MV) {
		return 1U;
	}

	return 0U;
}

static int battery_voltage_sample_mv(uint16_t *voltage_mv)
{
	int16_t sample;
	int32_t sample_mv;
	int err;
	struct adc_sequence sequence = {
		.channels = BIT(BATTERY_ADC_CHANNEL),
		.buffer = &sample,
		.buffer_size = sizeof(sample),
		.resolution = BATTERY_ADC_RESOLUTION,
		.oversampling = BATTERY_ADC_OVERSAMPLING,
	};

	if (!voltage_mv) {
		return -EINVAL;
	}

	if (!battery_adc_ready) {
		return -ENODEV;
	}

	err = adc_read(battery_adc, &sequence);
	if (err) {
		printk("Battery ADC read failed (err %d)\n", err);
		return err;
	}

	sample_mv = sample;
	err = adc_raw_to_millivolts(BATTERY_ADC_REFERENCE_MV,
				    ADC_GAIN_1_4,
				    BATTERY_ADC_RESOLUTION,
				    &sample_mv);
	if (err) {
		printk("Battery ADC conversion failed (err %d)\n", err);
		return err;
	}

	if (sample_mv < 0 || sample_mv > UINT16_MAX) {
		return -ERANGE;
	}

	*voltage_mv = (uint16_t)sample_mv;
	return 0;
}

static int battery_voltage_measure_store(void)
{
	uint16_t voltage_mv;
	uint8_t battery_status;
	int err;

	err = battery_voltage_sample_mv(&voltage_mv);
	if (err) {
		return err;
	}

	atomic_set(&stored_voltage_mv, voltage_mv);
	battery_status = battery_voltage_status_from_mv(voltage_mv);
	device_set_network_status_bits(
		BATTERY_LEVEL_MASK,
		battery_status << P_SHIFT_STATUS_BATTERY);

	printk("Measured battery voltage %u mV, status %u\n",
	       voltage_mv, battery_status);
	return 0;
}

static void battery_voltage_measure_handler(struct k_work *work)
{
	int err;

	ARG_UNUSED(work);

	err = battery_voltage_measure_store();
	if (err) {
		printk("Periodic battery voltage measurement failed (err %d)\n",
		       err);
	}

	k_work_schedule(&battery_voltage_measure_work,
			K_MSEC(CONFIG_DSA_BATTERY_MEASURE_INTERVAL_MS));
}
```

## src/battery_voltage.h
```c
#ifndef BATTERY_VOLTAGE_H
#define BATTERY_VOLTAGE_H

#include <stdint.h>

int battery_voltage_init(void);
int battery_voltage_read_mv(uint16_t *voltage_mv);
uint8_t battery_voltage_status_from_mv(uint16_t voltage_mv);

#endif /* BATTERY_VOLTAGE_H */
```

## src/defines.h
```c
#ifndef DEFINES_H
#define DEFINES_H

#define DSA_NUS_FLAG_TIME     0x01
#define DSA_NUS_FLAG_DATA       0x02
#define DSA_NUS_FLAG_VOLTAGE    0x03


#endif /* DEFINES_H */
```

## src/development_validation.c
```c
/* Development-only synthetic validation data generator. */

#include <stdint.h>

#include <zephyr/kernel.h>
#include <zephyr/random/random.h>
#include <zephyr/sys/printk.h>

#include "development_validation.h"
#include "network.h"
#include "self_report.h"

#define SYNTHETIC_CONTACT_TIME_MAX 0x00ffffffU

#if defined(CONFIG_DSA_DEV_SYNTHETIC_CONTACTS)
void development_validation_fill_random_contacts(uint16_t count)
{
	for (uint16_t i = 0; i < count; i++) {
		uint8_t id = (uint8_t)((i + 1U) & UINT8_MAX);
		uint32_t uptime_s = (i + 1U) & SYNTHETIC_CONTACT_TIME_MAX;
		uint8_t rssi = 30U + (sys_rand8_get() % 70U);

		network_development_validation_append_contact(
			id, uptime_s, rssi);
	}

	printk("Filled network contact buffer with %u synthetic entries\n",
	       count);
}
#endif

#if defined(CONFIG_DSA_DEV_SYNTHETIC_SELF_REPORTS)
void development_validation_fill_self_reports(uint16_t count)
{
	uint32_t uptime_s = (uint32_t)k_uptime_seconds();

	for (uint16_t i = 0; i < count; i++) {
		uint32_t age_s = sys_rand32_get() & 0x00ffffffU;

		self_report_development_validation_append(uptime_s - age_s);
	}

	printk("Filled self-report buffer with %u synthetic entries\n", count);
}
#endif
```

## src/development_validation.h
```c
#ifndef DEVELOPMENT_VALIDATION_H
#define DEVELOPMENT_VALIDATION_H

#include <stdint.h>

#if defined(CONFIG_DSA_DEV_SYNTHETIC_CONTACTS)
void development_validation_fill_random_contacts(uint16_t count);
#endif

#if defined(CONFIG_DSA_DEV_SYNTHETIC_SELF_REPORTS)
void development_validation_fill_self_reports(uint16_t count);
#endif

#endif /* DEVELOPMENT_VALIDATION_H */
```

## src/device.c
```c
#include <zephyr/bluetooth/bluetooth.h>
#include <zephyr/sys/atomic.h>
#include <zephyr/sys/printk.h>
#include "radio_ids.h"
#include "device.h"
#include "radio.h"

struct device_status {
    atomic_t radio;
    atomic_t network;
};

static struct device_status status_device;
static atomic_t storage_faults;
static atomic_t storage_full;

uint8_t lookup_device_id(const bt_addr_le_t *addr)
{
    for (size_t i = 0; i < known_device_table_len; i++) {
        if (bt_addr_le_cmp(addr, &known_device_table[i].addr) == 0) {
            return known_device_table[i].id;
        }
    }

    return 0xff; // unknown / unassigned
}

uint8_t get_device_id()
{
    static uint8_t device_id = 0xff;

    bt_addr_le_t addrs[CONFIG_BT_ID_MAX];
    size_t count = CONFIG_BT_ID_MAX;

    // Retrieve all addresses registered for the Bluetooth stack
    bt_id_get(addrs, &count);

	if (count > 0) {
		device_id = lookup_device_id(&addrs[0]);
	} else {
		printk("No Bluetooth identity address available, using unknown device id\n");
	}
	return device_id;
}

uint8_t device_get_radio_status(void)
{
    return (uint8_t)atomic_get(&status_device.radio);
}

void device_set_radio_status(uint8_t status)
{
    atomic_set(&status_device.radio, status);
}

void device_set_radio_status_bit(uint8_t mask, bool active)
{
    if (active) {
        atomic_or(&status_device.radio, mask);
    } else {
        atomic_and(&status_device.radio, (atomic_val_t)~mask);
    }
}

void device_set_storage_fault(uint32_t fault, bool active)
{
	atomic_val_t faults;
	uint8_t previous = device_get_radio_status();

	if (active) {
		atomic_or(&storage_faults, fault);
	} else {
		atomic_and(&storage_faults, (atomic_val_t)~fault);
	}

	faults = atomic_get(&storage_faults);
	device_set_radio_status_bit(STORAGE_STATUS_PARAM_ERROR,
				    (faults & STORAGE_FAULT_PARAM_MASK) != 0);
	device_set_radio_status_bit(STORAGE_STATUS_STORAGE_ERROR,
				    (faults & STORAGE_FAULT_STORAGE_MASK) != 0);

	if (device_get_radio_status() != previous) {
		radio_schedule_status_update();
	}
}

uint32_t device_get_storage_faults(void)
{
	return (uint32_t)atomic_get(&storage_faults);
}

void device_set_storage_full(uint32_t domain, bool active)
{
	atomic_val_t full;
	uint8_t previous = device_get_radio_status();

	if (active) {
		atomic_or(&storage_full, domain);
	} else {
		atomic_and(&storage_full, (atomic_val_t)~domain);
	}

	full = atomic_get(&storage_full);
	device_set_radio_status_bit(STORAGE_STATUS_STORAGE_FULL, full != 0);

	if (device_get_radio_status() != previous) {
		radio_schedule_status_update();
	}
}

uint32_t device_get_storage_full(void)
{
	return (uint32_t)atomic_get(&storage_full);
}

uint8_t device_get_network_status(void)
{
    return (uint8_t)atomic_get(&status_device.network);
}

void device_set_network_status(uint8_t status)
{
    atomic_set(&status_device.network, status);
}

void device_set_network_status_bits(uint8_t mask, uint8_t status)
{
	uint8_t previous;
	uint8_t updated;

	previous = device_get_network_status();
	updated = (previous & ~mask) | (status & mask);
	atomic_set(&status_device.network, updated);

	if (updated != previous) {
		radio_schedule_status_update();
	}
}
```

## src/device.h
```c
#pragma once

#include <stdbool.h>
#include <stdint.h>

#include <zephyr/bluetooth/addr.h>
#include <zephyr/sys/util.h>

/* Bit layout of the advertised radio/storage status byte (ADV_POS_RADIO_STATUS
 * in common_include.h). Bits 0/1/5/6 (RADIO_STATUS_*, RADIO_STATUS_MOTION_UNAVAILABLE,
 * RADIO_STATUS_MOTION_PROBE_TIMEOUT) live in common_include.h since they're set
 * directly, not derived from the storage_faults/storage_full aggregates below.
 * Bit 7 is reserved.
 */
#define STORAGE_STATUS_STORAGE_FULL	BIT(2)
#define STORAGE_STATUS_PARAM_ERROR	BIT(3)
#define STORAGE_STATUS_STORAGE_ERROR	BIT(4)

#define STORAGE_FAULT_LED_PARAMS		BIT(0)
#define STORAGE_FAULT_NETWORK_PARAMS	BIT(1)
#define STORAGE_FAULT_RADIO_PARAMS	BIT(2)
#define STORAGE_FAULT_CONTACT_INIT	BIT(3)
#define STORAGE_FAULT_CONTACT_READ	BIT(4)
#define STORAGE_FAULT_CONTACT_WRITE	BIT(5)
#define STORAGE_FAULT_CONTACT_DELETE	BIT(6)
#define STORAGE_FAULT_CONTACT_META	BIT(7)
#define STORAGE_FAULT_SELF_REPORT_INIT	BIT(8)
#define STORAGE_FAULT_SELF_REPORT_READ	BIT(9)
#define STORAGE_FAULT_SELF_REPORT_WRITE	BIT(10)
#define STORAGE_FAULT_SELF_REPORT_DELETE BIT(11)
#define STORAGE_FAULT_SELF_REPORT_META	BIT(12)
#define STORAGE_FAULT_ECO_LOG_INIT	BIT(13)
#define STORAGE_FAULT_ECO_LOG_READ	BIT(14)
#define STORAGE_FAULT_ECO_LOG_WRITE	BIT(15)
#define STORAGE_FAULT_ECO_LOG_DELETE	BIT(16)
#define STORAGE_FAULT_ECO_LOG_META	BIT(17)
#define STORAGE_FAULT_MOTION_PARAMS	BIT(18)

#define STORAGE_FAULT_PARAM_MASK \
	(STORAGE_FAULT_LED_PARAMS | STORAGE_FAULT_NETWORK_PARAMS | \
	 STORAGE_FAULT_RADIO_PARAMS | STORAGE_FAULT_MOTION_PARAMS)
/* Any I/O or metadata fault across the three flash-backed domains: distinct
 * record/metadata faults aren't worth separate advertised bits, since both
 * mean the same thing to someone who can only reach the tag over BLE - the
 * storage subsystem is unhealthy.
 */
#define STORAGE_FAULT_STORAGE_MASK \
	(STORAGE_FAULT_CONTACT_INIT | STORAGE_FAULT_CONTACT_READ | \
	 STORAGE_FAULT_CONTACT_WRITE | STORAGE_FAULT_CONTACT_DELETE | \
	 STORAGE_FAULT_CONTACT_META | \
	 STORAGE_FAULT_SELF_REPORT_INIT | STORAGE_FAULT_SELF_REPORT_READ | \
	 STORAGE_FAULT_SELF_REPORT_WRITE | STORAGE_FAULT_SELF_REPORT_DELETE | \
	 STORAGE_FAULT_SELF_REPORT_META | \
	 STORAGE_FAULT_ECO_LOG_INIT | STORAGE_FAULT_ECO_LOG_READ | \
	 STORAGE_FAULT_ECO_LOG_WRITE | STORAGE_FAULT_ECO_LOG_DELETE | \
	 STORAGE_FAULT_ECO_LOG_META)

/* Domain bits for device_set_storage_full(), distinct from the fault bits
 * above: "full" isn't an I/O error, it means the ring is healthy but out of
 * room and has started discarding its oldest un-exported entries.
 */
#define STORAGE_FULL_CONTACT		BIT(0)
#define STORAGE_FULL_SELF_REPORT	BIT(1)
#define STORAGE_FULL_ECO_LOG		BIT(2)

uint8_t get_device_id(void);
uint8_t lookup_device_id(const bt_addr_le_t *addr);

uint8_t device_get_radio_status(void);
void device_set_radio_status(uint8_t status);
void device_set_radio_status_bit(uint8_t mask, bool active);
void device_set_storage_fault(uint32_t fault, bool active);
uint32_t device_get_storage_faults(void);
void device_set_storage_full(uint32_t domain, bool active);
uint32_t device_get_storage_full(void);

uint8_t device_get_network_status(void);
void device_set_network_status(uint8_t status);
void device_set_network_status_bits(uint8_t mask, uint8_t status);
```

## src/eco_log.c
```c
#include <errno.h>
#include <stdbool.h>
#include <string.h>

#include <zephyr/kernel.h>
#include <zephyr/sys/printk.h>
#include <zephyr/sys/util.h>

#include "device.h"
#include "eco_log.h"
#include "eco_log_storage.h"
#include "ram_log_ring.h"
#include "storage_work_queue.h"

BUILD_ASSERT(CONFIG_DSA_ECO_LOG_RING_COUNT > 0,
	     "Eco log ring buffer must have at least one entry");
BUILD_ASSERT(CONFIG_DSA_ECO_LOG_FLUSH_BATCH <=
	     CONFIG_DSA_ECO_LOG_FLUSH_THRESHOLD,
	     "Eco log flush batch must not exceed threshold");
BUILD_ASSERT(CONFIG_DSA_ECO_LOG_FLUSH_THRESHOLD <=
	     CONFIG_DSA_ECO_LOG_RING_COUNT,
	     "Eco log flush threshold exceeds RAM ring");
BUILD_ASSERT(CONFIG_DSA_ECO_LOG_FLUSH_BATCH <=
	     ECO_LOG_STORAGE_BLOCK_ENTRIES,
	     "Eco log flush batch exceeds flash block");

static bool pending_session_open;
static uint32_t pending_enter_uptime_s;
static K_MUTEX_DEFINE(pending_session_lock);

static const struct ram_log_ring_config eco_log_cfg = {
	.ring_count = CONFIG_DSA_ECO_LOG_RING_COUNT,
	.entry_size = ECO_LOG_ENTRY_SIZE,
	.flush_threshold = CONFIG_DSA_ECO_LOG_FLUSH_THRESHOLD,
	.flush_batch = CONFIG_DSA_ECO_LOG_FLUSH_BATCH,
	.flush_retry_ms = CONFIG_DSA_ECO_LOG_FLUSH_RETRY_MS,
	.storage_init = eco_log_storage_init,
	.storage_append = eco_log_storage_append,
	.storage_peek = eco_log_storage_peek,
	.storage_drop = eco_log_storage_drop,
	.storage_sync = eco_log_storage_sync,
	.storage_get_count = eco_log_storage_get_count,
	.storage_full_bit = STORAGE_FULL_ECO_LOG,
	.domain_name = "eco log",
};

static uint8_t eco_log_entries[CONFIG_DSA_ECO_LOG_RING_COUNT *
			       ECO_LOG_ENTRY_SIZE];
static uint8_t eco_log_flush_buffer[ECO_LOG_STORAGE_BLOCK_ENTRIES *
				    ECO_LOG_ENTRY_SIZE];
static K_MUTEX_DEFINE(eco_log_lock);

static struct ram_log_ring eco_log_ring = {
	.cfg = &eco_log_cfg,
	.lock = &eco_log_lock,
	.entries = eco_log_entries,
	.flush_buffer = eco_log_flush_buffer,
};

static void eco_time_put(uint8_t time[3], uint32_t uptime_s)
{
	time[0] = (uptime_s >> 16) & 0xff;
	time[1] = (uptime_s >> 8) & 0xff;
	time[2] = uptime_s & 0xff;
}

static void eco_log_store(uint32_t enter_s, uint32_t leave_s)
{
	uint8_t entry[ECO_LOG_ENTRY_SIZE];

	eco_time_put(&entry[0], enter_s);
	eco_time_put(&entry[3], leave_s);
	if (!ram_log_ring_push(&eco_log_ring, entry)) {
		return;
	}

	printk("Logged eco session %u..%u s\n", enter_s, leave_s);
}

int eco_log_init(void)
{
	int err;

	storage_work_queue_init();
	ram_log_ring_init(&eco_log_ring);
	err = eco_log_storage_init();
	if (err) {
		printk("Failed to initialize eco log NVM storage (err %d)\n",
		       err);
		return err;
	}

	return 0;
}

void eco_log_enter(void)
{
	k_mutex_lock(&pending_session_lock, K_FOREVER);
	pending_enter_uptime_s = (uint32_t)k_uptime_seconds();
	pending_session_open = true;
	k_mutex_unlock(&pending_session_lock);
}

void eco_log_leave(void)
{
	uint32_t enter_s;
	uint32_t leave_s;

	k_mutex_lock(&pending_session_lock, K_FOREVER);
	if (!pending_session_open) {
		k_mutex_unlock(&pending_session_lock);
		return;
	}
	enter_s = pending_enter_uptime_s;
	leave_s = (uint32_t)k_uptime_seconds();
	pending_session_open = false;
	k_mutex_unlock(&pending_session_lock);

	eco_log_store(enter_s, leave_s);
}

int eco_log_export_begin(uint8_t *buffer, uint16_t buffer_len,
			 uint16_t *bytes_written)
{
	return ram_log_ring_export_begin(&eco_log_ring, buffer, buffer_len,
					 bytes_written);
}

int eco_log_export_commit(void)
{
	return ram_log_ring_export_commit(&eco_log_ring);
}

int eco_log_sync_storage(void)
{
	return ram_log_ring_sync(&eco_log_ring);
}

void eco_log_export_abort(void)
{
	ram_log_ring_export_abort(&eco_log_ring);
}

int eco_log_get_count(uint16_t *count)
{
	return ram_log_ring_get_count(&eco_log_ring, count);
}
```

## src/eco_log.h
```c
#ifndef ECO_LOG_H
#define ECO_LOG_H

#include <stdint.h>

#define ECO_LOG_ENTRY_SIZE 6U

int eco_log_init(void);
void eco_log_enter(void);
void eco_log_leave(void);
int eco_log_export_begin(uint8_t *buffer, uint16_t buffer_len,
			 uint16_t *bytes_written);
int eco_log_export_commit(void);
void eco_log_export_abort(void);
int eco_log_sync_storage(void);
int eco_log_get_count(uint16_t *count);

#endif /* ECO_LOG_H */
```

## src/eco_log_storage.c
```c
#include <zephyr/kernel.h>
#include <zephyr/storage/flash_map.h>
#include <zephyr/sys/util.h>

#include "device.h"
#include "eco_log.h"
#include "eco_log_storage.h"
#include "flash_ring_store.h"

#define ECO_LOG_STORAGE_PARTITION eco_log_storage
#define ECO_LOG_STORAGE_MAGIC 0x44534145U
#define ECO_LOG_STORAGE_VERSION 1U

BUILD_ASSERT(FIXED_PARTITION_SIZE(ECO_LOG_STORAGE_PARTITION) ==
	     CONFIG_DSA_ECO_LOG_FLASH_SIZE_BYTES,
	     "Eco log NVS partition size mismatch");
BUILD_ASSERT((CONFIG_DSA_ECO_LOG_FLASH_SIZE_BYTES %
	      FLASH_RING_STORE_SECTOR_SIZE) == 0,
	     "Eco log NVS partition must contain whole sectors");
BUILD_ASSERT(CONFIG_DSA_ECO_LOG_FLASH_SIZE_BYTES >=
	     (2U * FLASH_RING_STORE_SECTOR_SIZE),
	     "Eco log NVS partition must contain at least two sectors");
BUILD_ASSERT(CONFIG_DSA_ECO_LOG_FLUSH_BATCH <=
	     ECO_LOG_STORAGE_BLOCK_ENTRIES,
	     "Eco log flush batch exceeds flash block");

static const struct flash_ring_store_config eco_log_cfg = {
	.flash_device = FIXED_PARTITION_DEVICE(ECO_LOG_STORAGE_PARTITION),
	.offset = FIXED_PARTITION_OFFSET(ECO_LOG_STORAGE_PARTITION),
	.partition_size = CONFIG_DSA_ECO_LOG_FLASH_SIZE_BYTES,
	.magic = ECO_LOG_STORAGE_MAGIC,
	.version = ECO_LOG_STORAGE_VERSION,
	.entry_size = ECO_LOG_ENTRY_SIZE,
	.block_entry_capacity = ECO_LOG_STORAGE_BLOCK_ENTRIES,
	.block_count = FLASH_RING_STORE_BLOCK_COUNT(CONFIG_DSA_ECO_LOG_FLASH_SIZE_BYTES),
	.flush_batch = CONFIG_DSA_ECO_LOG_FLUSH_BATCH,
	.storage_fault_init = STORAGE_FAULT_ECO_LOG_INIT,
	.storage_fault_read = STORAGE_FAULT_ECO_LOG_READ,
	.storage_fault_write = STORAGE_FAULT_ECO_LOG_WRITE,
	.storage_fault_meta = STORAGE_FAULT_ECO_LOG_META,
	.storage_fault_delete = STORAGE_FAULT_ECO_LOG_DELETE,
	.domain_name = "eco log",
};

/* Aligned so flash_ring_store's block_header()/block_entries() casts (which
 * dereference uint32_t/uint16_t fields at the start of this buffer) are
 * well-defined rather than relying on incidental static-storage alignment.
 */
static uint8_t eco_log_block_cache[FLASH_RING_STORE_BLOCK_SIZE(
	ECO_LOG_STORAGE_BLOCK_ENTRIES, ECO_LOG_ENTRY_SIZE)]
	__aligned(4);

static K_MUTEX_DEFINE(eco_log_lock);

static struct flash_ring_store eco_log_store = {
	.cfg = &eco_log_cfg,
	.lock = &eco_log_lock,
	.block_cache = eco_log_block_cache,
	.block_cache_size = sizeof(eco_log_block_cache),
};

int eco_log_storage_init(void)
{
	return flash_ring_store_init(&eco_log_store);
}

int eco_log_storage_append(const uint8_t *entries, uint16_t entry_count)
{
	return flash_ring_store_append(&eco_log_store, entries, entry_count);
}

int eco_log_storage_peek(uint8_t *buffer, uint16_t buffer_len,
			 uint16_t *bytes_written)
{
	return flash_ring_store_peek(&eco_log_store, buffer, buffer_len,
				     bytes_written);
}

int eco_log_storage_drop(uint16_t entry_count, bool *block_retired)
{
	return flash_ring_store_drop(&eco_log_store, entry_count,
				     block_retired);
}

int eco_log_storage_sync(void)
{
	return flash_ring_store_sync(&eco_log_store);
}

int eco_log_storage_get_count(uint32_t *count)
{
	return flash_ring_store_get_count(&eco_log_store, count);
}
```

## src/eco_log_storage.h
```c
#ifndef ECO_LOG_STORAGE_H
#define ECO_LOG_STORAGE_H

#include <stdbool.h>
#include <stdint.h>

#define ECO_LOG_STORAGE_BLOCK_ENTRIES 16U

int eco_log_storage_init(void);
int eco_log_storage_append(const uint8_t *entries, uint16_t entry_count);
int eco_log_storage_peek(uint8_t *buffer, uint16_t buffer_len,
			 uint16_t *bytes_written);
int eco_log_storage_drop(uint16_t entry_count, bool *block_retired);
int eco_log_storage_sync(void);
int eco_log_storage_get_count(uint32_t *count);

#endif /* ECO_LOG_STORAGE_H */
```
